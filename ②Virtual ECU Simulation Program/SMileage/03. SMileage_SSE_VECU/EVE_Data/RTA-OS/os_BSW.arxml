AUTOSAR XML (schema 4-0-2)
package /Os_Task
  module config Os_Task: definition=Os
    BswAlarm (OsAlarm): OsAlarmCounterRef=BswCounter
      Action (OsAlarmAction)
        ActTask (OsAlarmActivateTask): OsAlarmActivateTaskRef=BswTask
      Autostart (OsAlarmAutostart): OsAlarmAutostartType=RELATIVE, OsAlarmAlarmTime=1, OsAlarmCycleTime=1, OsAlarmAppModeRef=OSDEFAULTAPPMODE
    BswTask (OsTask): OsTaskPriority=10, OsTaskActivation=5, OsTaskSchedule=FULL, OsTaskResourceRef=RTE_RESOURCE
    BswInit (OsTask): OsTaskPriority=9, OsTaskActivation=2, OsTaskSchedule=NON, OsTaskResourceRef=RTE_RESOURCE
    BswCounter (OsCounter): OsCounterMaxAllowedValue=65535, OsCounterMinCycle=1, OsCounterTicksPerBase=1, OsSecondsPerTick=0.1, OsCounterType=SOFTWARE
