AUTOSAR XML (schema 4-0-2)
package /Os_Task
  module config Os_Task: definition=Os
    XCPTask (OsTask): OsTaskPriority=25, OsTaskSchedule=FULL, OsTaskActivation=20, OsTaskResourceRef=RTE_RESOURCE
    XCP_Counter (OsCounter): OsCounterMinCycle=1, OsCounterMaxAllowedValue=65535, OsCounterTicksPerBase=1, OsSecondsPerTick=0.1, OsCounterType=SOFTWARE
    XCP_Alarm (OsAlarm): OsAlarmCounterRef=XCP_Counter
      Action (OsAlarmAction)
        ActTask (OsAlarmActivateTask): OsAlarmActivateTaskRef=XCPTask
      Autostart (OsAlarmAutostart): OsAlarmAutostartType=RELATIVE, OsAlarmAlarmTime=1, OsAlarmCycleTime=1, OsAlarmAppModeRef=OSDEFAULTAPPMODE
