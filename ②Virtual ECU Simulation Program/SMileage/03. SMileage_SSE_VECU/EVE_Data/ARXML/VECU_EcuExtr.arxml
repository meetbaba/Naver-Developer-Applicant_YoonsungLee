AUTOSAR XML (schema 4-1-1)
package /VECU_EcuExtract
  system EXTR_VECU_Instance: category=ECU_EXTRACT
    system mapping SYSMPG_VECU_Instance
      sw-mappings:
        swc to ecu mapping SwcToEcuMapping_0: ecu-instance=VECU_Instance
          component:
            CPT_VECU_Instance_FlatView.SwComponentPrototype_CoolantTemperaturePlausi
            CPT_VECU_Instance_FlatView.SwComponentPrototype_CrankshaftPositionPlausi
            CPT_VECU_Instance_FlatView.SwComponentPrototype_EngineECU
            CPT_VECU_Instance_FlatView.SwComponentPrototype_FuelCutActuator
            CPT_VECU_Instance_FlatView.SwComponentPrototype_FuelCutAlgo
            CPT_VECU_Instance_FlatView.SwComponentPrototype_GyroPlausi
            CPT_VECU_Instance_FlatView.SwComponentPrototype_VehicleSpeedPlausi
    root-software-compositions:
      root sw composition prototype CPT_VECU_Instance_FlatView: flat-map=VECU_Instance_FlatMap, software-composition=VECU_Instance_FlatView
