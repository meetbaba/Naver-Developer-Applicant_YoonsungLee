AUTOSAR XML (schema 4-1-1)
package /Rte_OS_Task
  module config Rte_OS_Task: definition=Rte
    7 x RteSwComponentInstance:
      SwComponentPrototype_EngineECU_0: RteSoftwareComponentInstanceRef=SwComponentPrototype_EngineECU
        RE_SendData (RteEventToTaskMapping): RtePositionInTask=1, RteActivationOffset=0.0, RteMappedToTaskRef=OsTask_ECU, RteEventRef=TE_SendData
        RE_SetFuelCutState (RteEventToTaskMapping): RtePositionInTask=1, RteActivationOffset=0.0, RteMappedToTaskRef=OsTask_SetFuelCutState, RteEventRef=OIE_SetFuelCutState
      SwComponentPrototype_CrankshaftPositionPlausi_0: RteSoftwareComponentInstanceRef=SwComponentPrototype_CrankshaftPositionPlausi
        RE_CrankshaftPositionPlausi (RteEventToTaskMapping): RtePositionInTask=1, RteActivationOffset=0.0, RteMappedToTaskRef=OsTask_Plausi, RteEventRef=OIE_SetCrankshaftPositionRaw
      SwComponentPrototype_VehicleSpeedPlausi_0: RteSoftwareComponentInstanceRef=SwComponentPrototype_VehicleSpeedPlausi
        RE_VehicleSpeedPlausi (RteEventToTaskMapping): RtePositionInTask=2, RteActivationOffset=0.0, RteMappedToTaskRef=OsTask_Plausi, RteEventRef=OIE_SetVehicleSpeedRaw
      SwComponentPrototype_CoolantTemperaturePlausi_0: RteSoftwareComponentInstanceRef=SwComponentPrototype_CoolantTemperaturePlausi
        RE_CoolantTemperaturePlausi (RteEventToTaskMapping): RtePositionInTask=3, RteActivationOffset=0.0, RteMappedToTaskRef=OsTask_Plausi, RteEventRef=OIE_SetCoolantTemperatureRaw
      SwComponentPrototype_GyroPlausi_0: RteSoftwareComponentInstanceRef=SwComponentPrototype_GyroPlausi
        RE_GyroPlausi (RteEventToTaskMapping): RtePositionInTask=4, RteActivationOffset=0.0, RteMappedToTaskRef=OsTask_Plausi, RteEventRef=OIE_SetGyroRaw
      SwComponentPrototype_FuelCutAlgo_0: RteSoftwareComponentInstanceRef=SwComponentPrototype_FuelCutAlgo
        8 x RteEventToTaskMapping, all with RteActivationOffset=0.0:
          RE_SetCoolantTemperature: RtePositionInTask=2, RteMappedToTaskRef=OsTask_Algo, RteEventRef=DRE_CoolantTempertaturePls
          RE_SetGyro: RtePositionInTask=3, RteMappedToTaskRef=OsTask_Algo, RteEventRef=DRE_GyroPls
          RE_SetGear: RtePositionInTask=7, RteMappedToTaskRef=OsTask_Algo, RteEventRef=OIE_SetGearLevel
          RE_SetVehicleSpeed: RtePositionInTask=1, RteMappedToTaskRef=OsTask_Algo, RteEventRef=DRE_VehicleSpeedPls
          RE_SetAccelerate: RtePositionInTask=4, RteMappedToTaskRef=OsTask_Algo, RteEventRef=OIE_SetAccelerateLevel
          RE_SetBrake: RtePositionInTask=5, RteMappedToTaskRef=OsTask_Algo, RteEventRef=OIE_SetBrakeLevel
          RE_SetCrankshaftPosition: RtePositionInTask=6, RteMappedToTaskRef=OsTask_Algo, RteEventRef=DRE_CrankshaftPositionPls
          RE_SetFuelCutAction: RtePositionInTask=1, RteMappedToTaskRef=OsTask_AlgoToActuator, RteEventRef=TE_SetFuelCutState
      SwComponentPrototype_FuelCutActuator_0: RteSoftwareComponentInstanceRef=SwComponentPrototype_FuelCutActuator
        RE_FuelCutActuator (RteEventToTaskMapping): RtePositionInTask=1, RteActivationOffset=0.0, RteMappedToTaskRef=OsTask_ActuatorToEngine, RteEventRef=DRE_FuelCutAction
