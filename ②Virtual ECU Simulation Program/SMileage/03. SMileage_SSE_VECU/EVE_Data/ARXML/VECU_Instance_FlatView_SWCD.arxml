AUTOSAR XML (schema 4-1-1)
package /VECU_Instance_FlatView/SwComponentTypes
  composition sw component type VECU_Instance_FlatView
    7 x component:
      SwComponentPrototype_CoolantTemperaturePlausi: type=CoolantTemperaturePlausi
      SwComponentPrototype_CrankshaftPositionPlausi: type=CrankshaftPositionPlausi
      SwComponentPrototype_EngineECU: type=EngineECU
      SwComponentPrototype_FuelCutActuator: type=FuelCutActuator
      SwComponentPrototype_FuelCutAlgo: type=FuelCutAlgo
      SwComponentPrototype_GyroPlausi: type=GyroPlausi
      SwComponentPrototype_VehicleSpeedPlausi: type=VehicleSpeedPlausi
    connect SwComponentPrototype_FuelCutAlgo.PPortFuelCutAction -> SwComponentPrototype_FuelCutActuator.RPortFuelCutAction
    connect SwComponentPrototype_EngineECU.PPortSetFuelCutState -> SwComponentPrototype_FuelCutActuator.RPortSetFuelCutState
    connect SwComponentPrototype_FuelCutAlgo.PPortBrake -> SwComponentPrototype_EngineECU.RPortBrake
    connect SwComponentPrototype_FuelCutAlgo.PPortAccelerate -> SwComponentPrototype_EngineECU.RPortAccelerate
    connect SwComponentPrototype_FuelCutAlgo.PPortGear -> SwComponentPrototype_EngineECU.RPortGear
    connect SwComponentPrototype_CoolantTemperaturePlausi.PPortCTRAW -> SwComponentPrototype_EngineECU.RPortCTRAW
    connect SwComponentPrototype_CrankshaftPositionPlausi.PPortCPRAW -> SwComponentPrototype_EngineECU.RPortCPRAW
    connect SwComponentPrototype_VehicleSpeedPlausi.PPortVSRAW -> SwComponentPrototype_EngineECU.RPortVSRAW
    connect SwComponentPrototype_GyroPlausi.PPortGyroRAW -> SwComponentPrototype_EngineECU.RPortGyroRAW
    connect SwComponentPrototype_CoolantTemperaturePlausi.PPortCTPLS -> SwComponentPrototype_FuelCutAlgo.RPortCTPLS
    connect SwComponentPrototype_CrankshaftPositionPlausi.PPortCPPLS -> SwComponentPrototype_FuelCutAlgo.RPortCPPLS
    connect SwComponentPrototype_VehicleSpeedPlausi.PPortVSPLS -> SwComponentPrototype_FuelCutAlgo.RPortVSPLS
    connect SwComponentPrototype_GyroPlausi.PPortGyroPLS -> SwComponentPrototype_FuelCutAlgo.RPortGyroPLS
