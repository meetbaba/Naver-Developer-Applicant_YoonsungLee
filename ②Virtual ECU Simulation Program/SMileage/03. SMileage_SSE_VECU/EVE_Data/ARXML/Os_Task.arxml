AUTOSAR XML (schema 4-1-1)
package /Os_Task
  module config Os_Task: definition=Os
    6 x OsTask, all with OsTaskActivation=1:
      OsTask_ECU: OsTaskPriority=1
      OsTask_Plausi: OsTaskPriority=2
      OsTask_Algo: OsTaskPriority=3
      OsTask_AlgoToActuator: OsTaskPriority=4
      OsTask_ActuatorToEngine: OsTaskPriority=5
      OsTask_SetFuelCutState: OsTaskPriority=6
