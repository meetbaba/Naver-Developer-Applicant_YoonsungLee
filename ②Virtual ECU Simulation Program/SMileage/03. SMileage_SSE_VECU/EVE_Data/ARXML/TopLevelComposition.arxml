AUTOSAR XML (schema 4-1-1)
package /TopLevelComposition
  composition sw component type TopLevelComposition
    7 x component:
      SwComponentPrototype_EngineECU: type=EngineECU
      SwComponentPrototype_CoolantTemperaturePlausi: type=CoolantTemperaturePlausi
      SwComponentPrototype_CrankshaftPositionPlausi: type=CrankshaftPositionPlausi
      SwComponentPrototype_FuelCutActuator: type=FuelCutActuator
      SwComponentPrototype_VehicleSpeedPlausi: type=VehicleSpeedPlausi
      SwComponentPrototype_GyroPlausi: type=GyroPlausi
      SwComponentPrototype_FuelCutAlgo: type=FuelCutAlgo
    connect SwComponentPrototype_FuelCutAlgo.PPortFuelCutAction -> SwComponentPrototype_FuelCutActuator.RPortFuelCutAction
    connect SwComponentPrototype_EngineECU.PPortSetFuelCutState -> SwComponentPrototype_FuelCutActuator.RPortSetFuelCutState
    connect SwComponentPrototype_CoolantTemperaturePlausi.PPortCTRAW -> SwComponentPrototype_EngineECU.RPortCTRAW
    connect SwComponentPrototype_CrankshaftPositionPlausi.PPortCPRAW -> SwComponentPrototype_EngineECU.RPortCPRAW
    connect SwComponentPrototype_VehicleSpeedPlausi.PPortVSRAW -> SwComponentPrototype_EngineECU.RPortVSRAW
    connect SwComponentPrototype_GyroPlausi.PPortGyroRAW -> SwComponentPrototype_EngineECU.RPortGyroRAW
    connect SwComponentPrototype_CoolantTemperaturePlausi.PPortCTPLS -> SwComponentPrototype_FuelCutAlgo.RPortCTPLS
    connect SwComponentPrototype_CrankshaftPositionPlausi.PPortCPPLS -> SwComponentPrototype_FuelCutAlgo.RPortCPPLS
    connect SwComponentPrototype_VehicleSpeedPlausi.PPortVSPLS -> SwComponentPrototype_FuelCutAlgo.RPortVSPLS
    connect SwComponentPrototype_GyroPlausi.PPortGyroPLS -> SwComponentPrototype_FuelCutAlgo.RPortGyroPLS
    connect SwComponentPrototype_FuelCutAlgo.PPortBrake -> SwComponentPrototype_EngineECU.RPortBrake
    connect SwComponentPrototype_FuelCutAlgo.PPortAccelerate -> SwComponentPrototype_EngineECU.RPortAccelerate
    connect SwComponentPrototype_FuelCutAlgo.PPortGear -> SwComponentPrototype_EngineECU.RPortGear
