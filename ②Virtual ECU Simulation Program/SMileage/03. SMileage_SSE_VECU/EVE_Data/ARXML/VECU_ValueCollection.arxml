AUTOSAR XML (schema 4-1-1)
package /VECU_ValueCollection
  ecuc value collection VECU_ValueCollection: ecu-extract=EXTR_VECU_Instance, ecuc-values=[Os_Task, Rte_OS_Task]
