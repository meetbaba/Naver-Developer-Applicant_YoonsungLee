AUTOSAR XML (schema 4-1-1)
package /VECU_Instance_FlatView
  flat map VECU_Instance_FlatMap
    20 x flat instance descriptor:
      SwComponentPrototype_CoolantTemperaturePlausi: upstream-reference=RootSwCompositionPrototype_0.SwComponentPrototype_CoolantTemperaturePlausi, ecu-extract-reference=CPT_VECU_Instance_FlatView.SwComponentPrototype_CoolantTemperaturePlausi
      coolantTemperature_pls: upstream-reference=RootSwCompositionPrototype_0.SwComponentPrototype_CoolantTemperaturePlausi.PPortCTPLS.coolantTemperature_pls, ecu-extract-reference=CPT_VECU_Instance_FlatView.SwComponentPrototype_CoolantTemperaturePlausi.PPortCTPLS.coolantTemperature_pls
      SwComponentPrototype_CrankshaftPositionPlausi: upstream-reference=RootSwCompositionPrototype_0.SwComponentPrototype_CrankshaftPositionPlausi, ecu-extract-reference=CPT_VECU_Instance_FlatView.SwComponentPrototype_CrankshaftPositionPlausi
      crankshaftPosition_pls: upstream-reference=RootSwCompositionPrototype_0.SwComponentPrototype_CrankshaftPositionPlausi.PPortCPPLS.crankshaftPosition_pls, ecu-extract-reference=CPT_VECU_Instance_FlatView.SwComponentPrototype_CrankshaftPositionPlausi.PPortCPPLS.crankshaftPosition_pls
      SwComponentPrototype_EngineECU: upstream-reference=RootSwCompositionPrototype_0.SwComponentPrototype_EngineECU, ecu-extract-reference=CPT_VECU_Instance_FlatView.SwComponentPrototype_EngineECU
      SwComponentPrototype_EngineECU_IB_EngineECU_eX_FuelCutState: upstream-reference=RootSwCompositionPrototype_0.SwComponentPrototype_EngineECU.eX_FuelCutState, ecu-extract-reference=CPT_VECU_Instance_FlatView.SwComponentPrototype_EngineECU.eX_FuelCutState
      SwComponentPrototype_FuelCutActuator: upstream-reference=RootSwCompositionPrototype_0.SwComponentPrototype_FuelCutActuator, ecu-extract-reference=CPT_VECU_Instance_FlatView.SwComponentPrototype_FuelCutActuator
      SwComponentPrototype_FuelCutAlgo: upstream-reference=RootSwCompositionPrototype_0.SwComponentPrototype_FuelCutAlgo, ecu-extract-reference=CPT_VECU_Instance_FlatView.SwComponentPrototype_FuelCutAlgo
      fuelCutAction: upstream-reference=RootSwCompositionPrototype_0.SwComponentPrototype_FuelCutAlgo.PPortFuelCutAction.fuelCutAction, ecu-extract-reference=CPT_VECU_Instance_FlatView.SwComponentPrototype_FuelCutAlgo.PPortFuelCutAction.fuelCutAction
      SwComponentPrototype_FuelCutAlgo_IB_FuelCutAlgo_eX_BrakeLevel: upstream-reference=RootSwCompositionPrototype_0.SwComponentPrototype_FuelCutAlgo.eX_BrakeLevel, ecu-extract-reference=CPT_VECU_Instance_FlatView.SwComponentPrototype_FuelCutAlgo.eX_BrakeLevel
      SwComponentPrototype_FuelCutAlgo_IB_FuelCutAlgo_eX_AccelerateLevel: upstream-reference=RootSwCompositionPrototype_0.SwComponentPrototype_FuelCutAlgo.eX_AccelerateLevel, ecu-extract-reference=CPT_VECU_Instance_FlatView.SwComponentPrototype_FuelCutAlgo.eX_AccelerateLevel
      SwComponentPrototype_FuelCutAlgo_IB_FuelCutAlgo_eX_GearLevel: upstream-reference=RootSwCompositionPrototype_0.SwComponentPrototype_FuelCutAlgo.eX_GearLevel, ecu-extract-reference=CPT_VECU_Instance_FlatView.SwComponentPrototype_FuelCutAlgo.eX_GearLevel
      SwComponentPrototype_FuelCutAlgo_IB_FuelCutAlgo_eX_VehicleSpeed: upstream-reference=RootSwCompositionPrototype_0.SwComponentPrototype_FuelCutAlgo.eX_VehicleSpeed, ecu-extract-reference=CPT_VECU_Instance_FlatView.SwComponentPrototype_FuelCutAlgo.eX_VehicleSpeed
      SwComponentPrototype_FuelCutAlgo_IB_FuelCutAlgo_eX_CrankshaftPosition: upstream-reference=RootSwCompositionPrototype_0.SwComponentPrototype_FuelCutAlgo.eX_CrankshaftPosition, ecu-extract-reference=CPT_VECU_Instance_FlatView.SwComponentPrototype_FuelCutAlgo.eX_CrankshaftPosition
      SwComponentPrototype_FuelCutAlgo_IB_FuelCutAlgo_eX_Gyro: upstream-reference=RootSwCompositionPrototype_0.SwComponentPrototype_FuelCutAlgo.eX_Gyro, ecu-extract-reference=CPT_VECU_Instance_FlatView.SwComponentPrototype_FuelCutAlgo.eX_Gyro
      SwComponentPrototype_FuelCutAlgo_IB_FuelCutAlgo_eX_CoolantTemperature: upstream-reference=RootSwCompositionPrototype_0.SwComponentPrototype_FuelCutAlgo.eX_CoolantTemperature, ecu-extract-reference=CPT_VECU_Instance_FlatView.SwComponentPrototype_FuelCutAlgo.eX_CoolantTemperature
      SwComponentPrototype_GyroPlausi: upstream-reference=RootSwCompositionPrototype_0.SwComponentPrototype_GyroPlausi, ecu-extract-reference=CPT_VECU_Instance_FlatView.SwComponentPrototype_GyroPlausi
      gyro_pls: upstream-reference=RootSwCompositionPrototype_0.SwComponentPrototype_GyroPlausi.PPortGyroPLS.gyro_pls, ecu-extract-reference=CPT_VECU_Instance_FlatView.SwComponentPrototype_GyroPlausi.PPortGyroPLS.gyro_pls
      SwComponentPrototype_VehicleSpeedPlausi: upstream-reference=RootSwCompositionPrototype_0.SwComponentPrototype_VehicleSpeedPlausi, ecu-extract-reference=CPT_VECU_Instance_FlatView.SwComponentPrototype_VehicleSpeedPlausi
      vehicleSpeed_pls: upstream-reference=RootSwCompositionPrototype_0.SwComponentPrototype_VehicleSpeedPlausi.PPortVSPLS.vehicleSpeed_pls, ecu-extract-reference=CPT_VECU_Instance_FlatView.SwComponentPrototype_VehicleSpeedPlausi.PPortVSPLS.vehicleSpeed_pls
