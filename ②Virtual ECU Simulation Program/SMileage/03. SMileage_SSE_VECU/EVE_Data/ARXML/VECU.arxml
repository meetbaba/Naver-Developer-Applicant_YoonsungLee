AUTOSAR XML (schema 4-1-1)
package /VECU
  system VECU: category=SYSTEM_EXTRACT
    system mapping SystemMapping_0
      sw-mappings:
        swc to ecu mapping SwcToEcuMapping_0: ecu-instance=VECU_Instance
          component:
            RootSwCompositionPrototype_0.SwComponentPrototype_CoolantTemperaturePlausi
            RootSwCompositionPrototype_0.SwComponentPrototype_CrankshaftPositionPlausi
            RootSwCompositionPrototype_0.SwComponentPrototype_EngineECU
            RootSwCompositionPrototype_0.SwComponentPrototype_FuelCutActuator
            RootSwCompositionPrototype_0.SwComponentPrototype_FuelCutAlgo
            RootSwCompositionPrototype_0.SwComponentPrototype_GyroPlausi
            RootSwCompositionPrototype_0.SwComponentPrototype_VehicleSpeedPlausi
    root-software-compositions:
      root sw composition prototype RootSwCompositionPrototype_0: software-composition=TopLevelComposition
  ecu instance VECU_Instance
