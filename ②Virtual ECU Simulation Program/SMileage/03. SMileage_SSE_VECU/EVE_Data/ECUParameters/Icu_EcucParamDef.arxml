AUTOSAR XML (schema 4-0-2)
package /ETASEVE/EcucDefs
  module definition Icu [0..*]: variants post-build/pre-compile  # Configuration of the Icu (Input Capture Unit) module.
    container IcuConfigSet: multiple-configuration-container=true  # This container is the base for a multiple configuration set
      integer IcuMaxChannel: 0..65535, set at post-build in variant post-build / pre-compile in variant pre-compile  # This parameter contains the number of Channels configured. It will be gathered by tools during the configuration stage. | calculationFormula = Number of configured Icu Channels Implementation Type: Icu_ChannelType
      container IcuChannel [1..*]  # Configuration of an individual ICU channel.
        integer IcuChannelId: 0..65535, set at post-build in variant post-build / pre-compile in variant pre-compile, symbolic-name-value=true  # Channel Id of the ICU channel. This value will be assigned to the symbolic name derived of the IcuChannel container short name.
        enumeration IcuDefaultStartEdge: {ICU_BOTH_EDGES, ICU_FALLING_EDGE, ICU_RISING_EDGE}, set at post-build in variant post-build / pre-compile in variant pre-compile  # Configures the default-activation-edge which shall be used for this channel if there was no activation-edge configured by the call of service Icu_SetActivationCondition(). | In case the Measurement Mode is "IcuSignalMeasurement" and the properties "DutyCycle" or "Period" are set, the edge configured here is used as Default Period Start Edge. Implementation Type: Icu_ActivationType
        enumeration IcuMeasurementMode: {ICU_MODE_EDGE_COUNTER, ICU_MODE_SIGNAL_EDGE_DETECT, ICU_MODE_SIGNAL_MEASUREMENT, ICU_MODE_TIMESTAMP}, set at post-build in variant post-build / pre-compile in variant pre-compile  # Configures the measurement mode of this channel. | Implementation Type: Icu_MeasurementModeType
        boolean IcuWakeupCapability: set at post-build in variant post-build / pre-compile in variant pre-compile  # Information about the wakeup-capability of this channel. | true: Channel is wakeup capable. false: Channel is not wakeup capable.
        container IcuSignalEdgeDetection [0..1]  # This container contains the configuration (parameters) in case the measurement mode is "IcuSignalEdgeDetection"
          function name IcuSignalNotification [0..1]: set at post-build in variant post-build / pre-compile in variant pre-compile  # Notification function for signal notification.
        container IcuSignalMeasurement [0..1]  # This container contains the configuration (parameters) in case the measurement mode is "IcuSignalMeasurement"
          enumeration IcuSignalMeasurementProperty: {ICU_ACTIVE_TIME, ICU_HIGH_TIME, ICU_LOW_TIME, ICU_PERIOD_TIME}, set at post-build in variant post-build / pre-compile in variant pre-compile  # Configures the property that could be measured in case the mode is "IcuSignalMeasurement". | This property can not be changed during runtime. Implementation Type: Icu_SignalMeasurementPropertyType
        container IcuTimestampMeasurement [0..1]  # This container contains the configuration (parameters) in case the measurement mode is "IcuTimestamp"
          enumeration IcuTimestampMeasurementProperty: {ICU_CIRCULAR_BUFFER, ICU_LINEAR_BUFFER}, set at post-build in variant post-build / pre-compile in variant pre-compile  # Configures the handling of the buffer in case the mode is "Timestamp" | Implementation Type: Icu_TimestampBufferType
          function name IcuTimestampNotification [0..1]: set at post-build in variant post-build / pre-compile in variant pre-compile  # Notification function if the number of requested timestamps | (Notification interval > 0) are acquired.
        container Eve_MappingInfo
          enumeration PcieCardId: {ES5340, OTHERS}, set at post-build in variant post-build / pre-compile in variant pre-compile  # Pcie Card ID from the list
          integer PcieCardInstance: set at pre-compile, default-value=1  # Instance of the PcieCard
          enumeration PcieCardPinNumber: {PORT_ES5340_PIN_DIO_IN00, PORT_ES5340_PIN_DIO_IN01, PORT_ES5340_PIN_DIO_IN02, PORT_ES5340_PIN_DIO_IN03, PORT_ES5340_PIN_DIO_IN04, PORT_ES5340_PIN_DIO_IN05, PORT_ES5340_PIN_DIO_IN06, PORT_ES5340_PIN_DIO_IN07, PORT_ES5340_PIN_DIO_IN08, PORT_ES5340_PIN_DIO_IN09, PORT_ES5340_PIN_DIO_IN10, PORT_ES5340_PIN_DIO_IN11, PORT_ES5340_PIN_DIO_IN12, PORT_ES5340_PIN_DIO_IN13, PORT_ES5340_PIN_DIO_IN14, PORT_ES5340_PIN_DIO_IN15, PORT_ES5340_PIN_DIO_IN16, PORT_ES5340_PIN_DIO_IN17, PORT_ES5340_PIN_DIO_IN18, PORT_ES5340_PIN_DIO_IN19}, set at post-build in variant post-build / pre-compile in variant pre-compile  # Card Pin number of ES5340 card pins
        container IcuWakeup [0..1]  # This container contains the configuration (parameters) needed to configure a wakeup capable channel
          symbolic name reference IcuChannelWakeupInfo [0..1]: set at post-build in variant post-build / pre-compile in variant pre-compile, destination=EcuMWakeupSource  # If the wakeup-capability is true the wakeup source referenced is transmitted to the ECU State Manager (EcuM) . | Implementation Type: reference to EcuM_WakeupSourceType
    container IcuGeneral  # Configuration of general ICU parameters.
      boolean IcuDevErrorDetect: set at pre-compile  # Switches the Development Error Detection and Notification | on or off. true: Enabled. false: Disabled.
      integer IcuIndex: 0..255, set at pre-compile  # Specifies the InstanceId of this module instance. If only one instance is present it shall have the Id 0.
      boolean IcuReportWakeupSource: set at pre-compile  # Switch for enabling Wakeup source reporting. | true: Report Wakeup source. false: Do not report Wakeup source.
    container IcuOptionalApis  # This container contains all configuration switches for configuring optional API services of the ICU driver.
      boolean IcuDeInitApi: set at pre-compile  # Adds / removes the service Icu_DeInit() from the code. | true: Icu_DeInit() can be used. false: Icu_DeInit() can not be used.
      boolean IcuDisableWakeupApi: set at pre-compile  # Adds / removes the service Icu_DisableWakeup() from the code. | true: Icu_DisableWakeup() can be used. false: Icu_DisableWakeup() can not be used.
      boolean IcuEdgeCountApi: set at pre-compile  # Adds / removes all services related to the edge counting functionality as listed below, from the code: Icu_ResetEdgeCount(), Icu_EnableEdgeCount(), Icu_DisableEdgeCount(), Icu_GetEdgeNumbers(). | true: The services listed above can be used. false: The services listed above can not be used.
      boolean IcuEdgeDetectApi: set at pre-compile  # Adds / removes the services related to the edge detection functionality, from the code: | Icu_EnableEdgeDetection() and Icu_DisableEdgeDetection(). true: These services can be used. false: These services can not be used.
      boolean IcuEnableWakeupApi: set at pre-compile  # Adds / removes the service Icu_EnableWakeup() from the code. | true: Icu_EnableWakeup() can be used. false: Icu_EnableWakeup() can not be used.
      boolean IcuGetDutyCycleValuesApi: set at pre-compile  # Adds / removes the service Icu_GetDutyCycleValues() from the code. | true: Icu_GetDutyCycleValues() can be used. false: Icu_GetDutyCycleValues() can not be used.
      boolean IcuGetInputStateApi: set at pre-compile  # Adds / removes the service Icu_GetInputState() from the code. | true: Icu_GetInputState() can be used. false: Icu_GetInputState() can not be used.
      boolean IcuGetTimeElapsedApi: set at pre-compile  # Adds / removes the service Icu_GetTimeElapsed() from the code. | true: Icu_GetTimeElapsed() can be used. false: Icu_GetTimeElapsed() can not be used.
      boolean IcuGetVersionInfoApi: set at pre-compile  # Adds / removes the service Icu_GetVersionInfo() from the code. | true: Icu_GetVersionInfo() can be used. false: Icu_GetVersionInfo() can not be used.
      boolean IcuSetModeApi: set at pre-compile  # Adds / removes the service Icu_SetMode() from the code. | true: Icu_SetMode() can be used. false: Icu_SetMode() can not be used.
      boolean IcuSignalMeasurementApi: set at pre-compile  # Adds / removes the services Icu_StartSignalMeasurement() and Icu_StopSignalMeasurement() from the code. | true: Icu_StartSignalMeasurement() and Icu_StopSignalMeasurement() can be used. false: Icu_StartSignalMeasurement() and Icu_StopSignalMeasurement() can not be used.
      boolean IcuTimestampApi: set at pre-compile  # Adds / removes all services related to the timestamping functionality as listed below from the code: Icu_StartTimestamp(), Icu_StopTimestamp(), Icu_GetTimestampIndex(). | true: The services listed above can be used. false: The services listed above can not be used.
      boolean IcuWakeupFunctionalityApi: set at pre-compile  # Adds / removes the service Icu_CheckWakeup() from the code. | true: Icu_CheckWakeup() can be used. false: Icu_CheckWakeup() cannot be used.
  module definition EcuM [0..1]: variants post-build  # Configuration of the EcuM (ECU State Manager) module.
    container EcuMConfiguration: multiple-configuration-container=true  # This container contains the configuration (parameters) of the ECU State Manager.
      container EcuMCommonConfiguration  # This container contains the common configuration (parameters) of the ECU State Manager.
        integer EcuMConfigConsistencyHash: 0..18446744073709551615, set at link  # A hash value generated across all pre-compile and link-time parameters of all BSW modules. This hash value is compared against a field in the EcuM_ConfigType and hence allows checking the consistency of the entire configuration.
        reference EcuMDefaultAppMode: set at post-build, destination=OsAppMode  # The default application mode loaded when the ECU comes out of reset.
        reference EcuMOSResource [1..*]: set at pre-compile, destination=OsResource  # This parameter is a reference to a OS ressource which is used to bring the ECU into sleep mode. | In case of multi core each core shall have an own OsResource.
        container EcuMDefaultShutdownTarget  # This container describes the default shutdown target to be selected by EcuM. The actual shutdown target may be overridden by the EcuM_SelectShutdownTarget service.
          enumeration EcuMDefaultState: {EcuMStateOff, EcuMStateReset, EcuMStateSleep}, set at post-build  # This parameter describes the state part of the default shutdown target selected when the ECU comes out of reset. If EcuMStateSleep is selected, the parameter EcuMDefaultSleepModeRef selects the specific sleep mode.
          symbolic name reference EcuMDefaultSleepModeRef [0..1]: set at post-build, destination=EcuMSleepMode  # If EcuMDefaultShutdownTarget is EcuMStateSleep, this parameter selects the default sleep mode. Otherwise this parameter may be ignored.
        container EcuMDemEventParameterRefs [0..1]  # Container for the references to DemEventParameter elements which shall be invoked using the API Dem_ReportErrorStatus in case the corresponding error occurs. The EventId is taken from the referenced DemEventParameter's DemEventId value. | The standardized errors are provided in this container and can be extended by vendor specific error references.
          symbolic name reference ECUM_E_ALL_RUN_REQUESTS_KILLED [0..1]: set at pre-compile, destination=DemEventParameter  # Reference to the DemEventParameter which shall be issued when the error "ECUM_E_ALL_RUN_REQUESTS_KILLED" has occured.
          symbolic name reference ECUM_E_CONFIGURATION_DATA_INCONSISTENT [0..1]: set at pre-compile, destination=DemEventParameter  # Reference to the DemEventParameter which shall be issued when the error "ECUM_E_CONFIGURATION_DATA_INCONSISTENT" has occured.
          symbolic name reference ECUM_E_RAM_CHECK_FAILED [0..1]: set at pre-compile, destination=DemEventParameter  # Reference to the DemEventParameter which shall be issued when the error "ECUM_E_RAM_CHECK_FAILED" has occured.
        container EcuMDriverInitListOne [0..1]  # Container for Init Block I. | This container holds a list of module IDs that will be initialised. Each module in the list will be called for initialisation in the list order. All modules in this list are initilialised before the OS is started and so these modules require no OS support.
          container EcuMDriverInitItem [1..*]  # These containers describe the entries in a driver init list.
            string EcuMModuleID: set at pre-compile  # Short name of the module to be initialized, e.g. Mcu, Gpt etc.
            string EcuMModuleService: set at pre-compile  # The service to be called to initialize that module, e.g. Init, PreInit, Start etc. | If the service is Init and the parameter EcuMModuleConfigurationRef has been set for that module, the corresponding pointer to the init structure (<Module>_ConfigType) and in case of multiple instantiation an uint8 value to identify the instance of the module(<MSN>_CtrlIdx) shall be passed as arguments.
        container EcuMDriverInitListZero [0..1]  # Container for Init Block 0. | This container holds a list of module IDs that will be initialised. Each module in the list will be called for initialisation in the list order. All modules in this list are initilialised before the post-build configuration has been loaded and the OS is initialized. Therefore, these modules may not use post-build configuration.
          container EcuMDriverInitItem [1..*]  # These containers describe the entries in a driver init list.
            string EcuMModuleID: set at pre-compile  # Short name of the module to be initialized, e.g. Mcu, Gpt etc.
            string EcuMModuleService: set at pre-compile  # The service to be called to initialize that module, e.g. Init, PreInit, Start etc. | If the service is Init and the parameter EcuMModuleConfigurationRef has been set for that module, the corresponding pointer to the init structure (<Module>_ConfigType) and in case of multiple instantiation an uint8 value to identify the instance of the module(<MSN>_CtrlIdx) shall be passed as arguments.
        container EcuMDriverRestartList [0..1]  # List of module IDs. | EcuM2719: A configuration tool shall fill the callout EcuM_AL_DriverRestart with initialization calls to the listed drivers in the order in which they occur in the list. EcuM2720: Entries in this list must appear in the same order as in the combined list of EcuM_DriverInitListOne and EcuM_DriverInitListTwo. This list may be a real subset though. In all other cases, the generation tool shall report an error. The included container has the same structure as EcuM_DriverInitItem
          container EcuMDriverInitItem [1..*]  # These containers describe the entries in a driver init list.
            string EcuMModuleID: set at pre-compile  # Short name of the module to be initialized, e.g. Mcu, Gpt etc.
            string EcuMModuleService: set at pre-compile  # The service to be called to initialize that module, e.g. Init, PreInit, Start etc. | If the service is Init and the parameter EcuMModuleConfigurationRef has been set for that module, the corresponding pointer to the init structure (<Module>_ConfigType) and in case of multiple instantiation an uint8 value to identify the instance of the module(<MSN>_CtrlIdx) shall be passed as arguments.
        container EcuMSleepMode [1..*]  # These containers describe the configured sleep modes. | The names of these containers specify the symbolic names of the different sleep modes.
          integer EcuMSleepModeId: 0..255, set at pre-compile, symbolic-name-value=true  # This ID identifies this sleep mode in services like EcuM_SelectShutdownTarget.
          boolean EcuMSleepModeSuspend: set at pre-compile  # Flag, which is set true, if the CPU is suspended, halted, or powered off in the sleep mode. If the CPU keeps running in this sleep mode, then this flag must be set to false.
          symbolic name reference EcuMSleepModeMcuModeRef: set at pre-compile, destination=McuModeSettingConf  # This parameter is a reference to the corresponding MCU mode for this sleep mode.
          symbolic name reference EcuMSleepModeWdgMModeRef [0..1]: set at pre-compile, destination=WdgMMode  # This parameter defines the Watchdog Manager mode that shall be active in this sleep mode. | Only applicable if EcuMFixed is implemented.
          symbolic name reference EcuMWakeupSourceMask [1..*]: set at pre-compile, destination=EcuMWakeupSource  # These parameters are references to the wakeup sources that shall be enabled for this sleep mode.
        container EcuMWakeupSource [1..*]  # These containers describe the configured wakeup sources.
          float EcuMValidationTimeout [0..1]: set at pre-compile  # The validation timeout (period for which the ECU State Manager will wait for the validation of a wakeup event) can be defined for each wakeup source independently. The timeout is specified in seconds. | When the timeout is not instantiated, there is no validation routine and the ECU Manager shall not validate the wakeup source.
          integer EcuMWakeupSourceId: 0..31, set at pre-compile, symbolic-name-value=true  # This parameter defines the identifier of this wakeup source.
          boolean EcuMWakeupSourcePolling: set at pre-compile  # This parameter describes if the wakeup source needs polling.
          symbolic name reference EcuMComMChannelRef [0..1]: set at pre-compile, destination=ComMChannel  # This parameter is a reference to a Network (channel) defined in the Communication Manager. No reference indicates that the wakeup source is not a communication channel.
          symbolic name reference EcuMResetReasonRef: set at pre-compile, destination=McuResetReasonConf  # This parameter describes the mapping of reset reasons detected by the MCU driver into wakeup sources.
      container EcuMFixedConfiguration [0..1]  # This container contains the configuration (parameters) of the EcuMFixed. | Only applicable if EcuMFixed is implemented.
        float EcuMNvramReadallTimeout: set at post-build  # Period given in seconds for which the ECU State Manager will wait until it considers a ReadAll job of the NVRAM Manager as failed.
        float EcuMNvramWriteallTimeout: set at post-build  # Period given in seconds for which the ECU State Manager will wait until it considers a WriteAll job of the NVRAM Manager as failed.
        float EcuMRunMinimumDuration: set at post-build  # Duration given in seconds for which the ECU State Manager will | stay in RUN state even when no one requests RUN. This duration should be long at least as long as a SW-Cs needs to request RUN.
        choice reference EcuMFixedModuleConfigurationRef [0..*]: set at post-build, destination=[AdcConfigSet, BswMConfig, CanConfigSet, CanIfInitCfg, CanNmGlobalConfig, CanSMConfiguration, CanTpConfig, ComConfig, DbgMultipleConfigurationContainer, DcmConfigSet, DemConfigSet, DioConfig, DltMultipleConfigurationContainer, EepInitConfiguration, EthConfigSet, EthIfConfigSet, EthTrcvConfigSet, FiMConfigSet, FlsConfigSet, FrIfConfig, FrMultipleConfiguration, FrNmChannelConfig, FrSMConfig, FrTpMultipleConfig, GptChannelConfigSet, IcuConfigSet, IpduMConfig, J1939TpConfiguration, LinGlobalConfig, LinIfGlobalConfig, LinTpGlobalConfig, McuModuleConfiguration, PduRRoutingTables, PortConfigSet, PwmChannelConfigSet, RtePostBuildVariantConfiguration, SoAdDoIpConfig, SpiDriver, UdpNmGlobalConfig, WdgMConfigSet, WdgSettingsConfig, XcpConfig]  # These parameters contain references to the init structure of the corresponding BSW module.
        symbolic name reference EcuMComMCommunicationAllowedList [0..*]: set at pre-compile, destination=ComMChannel  # These parameters contain references to the ComMChannels for which EcuM has to call ComM_CommunicationAllowed.
        symbolic name reference EcuMNormalMcuModeRef: set at pre-compile, destination=McuModeSettingConf  # This parameter is a reference to the normal MCU mode to be restored after a sleep.
        container EcuMDriverInitListThree [0..1]  # Container for Init Block III. | This container holds a list of module IDs that will be initialised. Each module in the list will be called for initialisation in the list order. All modules in this list are initilialised after the OS is started and so these modules may use OS support. These modules may also rely on the Nvram ReadAll job to have provided all data.
          container EcuMDriverInitItem [1..*]  # These containers describe the entries in a driver init list.
            string EcuMModuleID: set at pre-compile  # Short name of the module to be initialized, e.g. Mcu, Gpt etc.
            string EcuMModuleService: set at pre-compile  # The service to be called to initialize that module, e.g. Init, PreInit, Start etc. | If the service is Init and the parameter EcuMModuleConfigurationRef has been set for that module, the corresponding pointer to the init structure (<Module>_ConfigType) and in case of multiple instantiation an uint8 value to identify the instance of the module(<MSN>_CtrlIdx) shall be passed as arguments.
        container EcuMDriverInitListTwo [0..1]  # Container for Init Block II. | This container holds a list of module IDs that will be initialised. Each module in the list will be called for initialisation in the list order. All modules in this list are initilialised after the OS is started and so these modules may use OS support. These modules may not rely on the Nvram ReadAll job to have provided all data.
          container EcuMDriverInitItem [1..*]  # These containers describe the entries in a driver init list.
            string EcuMModuleID: set at pre-compile  # Short name of the module to be initialized, e.g. Mcu, Gpt etc.
            string EcuMModuleService: set at pre-compile  # The service to be called to initialize that module, e.g. Init, PreInit, Start etc. | If the service is Init and the parameter EcuMModuleConfigurationRef has been set for that module, the corresponding pointer to the init structure (<Module>_ConfigType) and in case of multiple instantiation an uint8 value to identify the instance of the module(<MSN>_CtrlIdx) shall be passed as arguments.
        container EcuMFixedUserConfig [1..*]  # These containers describe the identifiers that are needed to refer to a software component or another appropriate entity in the system which is designated to request the RUN state. Application requestors refer to entities above RTE, system requestors to entities below RTE (e.g. Communication Manager).
          integer EcuMFixedUser: 0..255, set at pre-compile, symbolic-name-value=true  # Parameter used to identify one user.
        container EcuMTTII [0..*]  # These containers describe the structures and the following configuration items describe its elements. These structures are concatenated to build a list as indicated by Figure 27 - Configuration Container Diagram. | The list must contain at least one element when ECUM_TTII_ENABLED is set to true.
          integer EcuMDivisor: 0..18446744073709551615, set at pre-compile  # This parameter defines the divisor preload value.
          symbolic name reference EcuMSleepModeRef: set at pre-compile, destination=EcuMSleepMode  # This configuration parameter is a reference to a configured sleep mode that is used for TTII.
          symbolic name reference EcuMSuccessorRef [0..1]: set at pre-compile, destination=EcuMSleepMode  # This parameter is a reference to the next sleep mode in the TTII protocol.
        container EcuMWdgM [0..1]  # This container holds the configuration parameters for the interaction between the Watchdog Manager (WdgM) and EcuM. The WdgM mode to be selected in a specific Sleep Mode of EcuM is configured in the EcuMSleepMode container.
          reference EcuMWdgMPostRunModeRef: set at post-build, destination=WdgMMode  # This parameter references the WdgM mode to be set when entering the POST RUN state of EcuM.
          reference EcuMWdgMRunModeRef: set at post-build, destination=WdgMMode  # This parameter references the WdgM mode to be set when entering the RUN state of EcuM.
          reference EcuMWdgMShutdownModeRef: set at post-build, destination=WdgMMode  # This parameter references the WdgM mode to be set when leaving the GO OFF I state of EcuM.
          reference EcuMWdgMStartupModeRef: set at post-build, destination=WdgMMode  # This parameter references the WdgM mode to be set when entering the STARTUP II state of EcuM.
          reference EcuMWdgMWakeupModeRef: set at post-build, destination=WdgMMode  # This parameter references the WdgM mode to be set when entering the WAKEUP I state of EcuM.
          symbolic name reference EcuMSupervisedEntityRef: set at post-build, destination=WdgMSupervisedEntity  # This parameter references the Supervised Entity ID that way configured for EcuM in the Watchdog Manager.
      container EcuMFlexConfiguration [0..1]  # This container contains the configuration (parameters) of the EcuMFlex. | Only applicable if EcuMFlex is implemented.
        choice reference EcuMFlexModuleConfigurationRef [0..*]: set at post-build, destination=[AdcConfigSet, CanConfigSet, DemConfigSet, FlsConfigSet, GptChannelConfigSet, IcuConfigSet, LinGlobalConfig, McuModuleConfiguration, PortConfigSet, PwmChannelConfigSet, SpiDriver, WdgMConfigSet, WdgSettingsConfig]  # These parameters contain references to the init structure of the corresponding BSW module.
        container EcuMAlarmClock [0..*]  # These containers describe the configured alarm clocks. | The name of these conatiners allows giving a symbolic name to one alarm clock.
          integer EcuMAlarmClockId: 0..255, set at pre-compile, symbolic-name-value=true  # This ID identifies this alarmclock.
          float EcuMAlarmClockTimeOut: set at pre-compile  # This parameter allows to define a timout for this alarm clock.
          symbolic name reference EcuMAlarmClockUser: set at pre-compile, destination=EcuMFlexUserConfig  # This parameter allows an alarm to be assigned to a user.
        container EcuMFlexUserConfig [1..*]  # These containers describe the identifiers that are needed to refer to a software component or another appropriate entity in the system which uses the EcuMFlex Interfaces.
          integer EcuMFlexUser: 0..255, set at pre-compile, symbolic-name-value=true  # Parameter used to identify one user.
          reference EcuMFlexEcucPartitionRef [0..1]: set at pre-compile, destination=EcucPartition  # Denotes in which "EcucPartition" the user of the EcuM is executed.
        container EcuMResetMode [1..*]  # These containers describe the configured reset modes. | The name of these containers allows one of the following symbolic names to be given to the different reset modes: - ECUM_RESET_MCU - ECUM_RESET_WDGM - ECUM_RESET_IO.
          integer EcuMResetModeId: 0..255, set at pre-compile, symbolic-name-value=true  # This ID identifies this reset mode in services like EcuM_SelectShutdownTarget.
        container EcuMSetClockAllowedUsers [0..1]  # This container describes the collection of allowed users which are allowed to call the EcuM_SetClock API.
          symbolic name reference EcuMSetClockAllowedUserRef [1..*]: set at pre-compile, destination=EcuMFlexUserConfig  # These parameters describe the references to the users which are allowed to call the EcuM_SetClock API.
        container EcuMShutdownCause [1..*]  # These containers describe the configured shut down or reset causes. | The name of these containers allows to give one of the following symbolic names to the diffenrent shut down causes: - ECUM_CAUSE_ECU_STATE - ECU state machine entered a state for shutdown, - ECUM_CAUSE_WDGM - WdgM detected failure, - ECUM_CAUSE_DCM - Dcm requests shutdown (split into UDS services?), - and values from configuration.
          integer EcuMShutdownCauseId: 0..255, set at pre-compile, symbolic-name-value=true  # This ID identifies this shut down cause.
        container EcuMShutdownTarget [1..*]  # These containers describe the configured shut down targets. | The name of these containers allows to give symbolic names to the different shut down targets.
          integer EcuMShutdownTargetId: 0..255, set at pre-compile, symbolic-name-value=true  # This ID identifies this shut down target in services like EcuM_SelectShutdownTarget.
    container EcuMFixedGeneral [0..1]  # This container holds the general, pre-compile configuration parameters for the EcuMFixed. | Only applicable if EcuMFixed is implemented.
      boolean EcuMIncludeComM: set at pre-compile  # This configuration parameter defines whether the communication manager is supported by EcuM. This feature is presented for development purpose to compile out the communication manager in the early debugging phase.
      boolean EcuMIncludeNvM: set at pre-compile  # This configuration parameter defines whether the non volatile memory manager is supported by EcuM. This feature is presented for development purpose to compile out the volatile memory manager in the early debugging phase.
      boolean EcuMIncludeNvramMgr: set at pre-compile  # If NVRAM manager is enabled but both flash and EEPROM driver are missing, then an error shall be flagged by the configuration tool
      boolean EcuMIncludeWdgM: set at pre-compile  # This configuration parameter defines whether the watchdog manager is supported by EcuM. This feature is presented for development purpose to compile out the watchdog manager in the early debugging phase.
      boolean EcuMTTIIEnabled: set at pre-compile  # Boolean switch to enable / disable TTII
      symbolic name reference EcuMTTIIWakeupSourceRef: set at pre-compile, destination=EcuMWakeupSource  # This configuration parameter references the initial sleep mode to be used by TTII when TTII is activated after a RUN mode. | EcuM2785: Whenever RUN mode is reached, the TTII protocol shall be reset to use the wakeup source referenced by this parameter. This configuration parameter is a human readable name for a TTII wakeup source which is only needed by the configuration tool. For imlementation on the ECU, this parameter may be dropped and replaced by a generated list index of EcuM_TTII.
    container EcuMFlexGeneral [0..1]  # This container holds the general, pre-compile configuration parameters for the EcuMFlex. | Only applicable if EcuMFlex is implemented.
      boolean EcuMAlarmClockPresent: set at pre-compile  # This flag indicates whether the optional AlarmClock feature is present.
      boolean EcuMResetLoopDetection: set at pre-compile  # If false, no reset loop detection is performed.
      symbolic name reference EcuMAlarmWakeupSource [0..1]: set at pre-compile, destination=EcuMWakeupSource  # This parameter describes the reference to the EcuMWakeupSource being used for the EcuM AlarmClock.
    container EcuMGeneral  # This container holds the general, pre-compile configuration parameters.
      boolean EcuMDevErrorDetect: set at pre-compile  # If false, no debug artifacts (e.g. calls to DET) shall remain in the executable object. Initialization of DET, however is controlled by configuration of optional BSW modules.
      boolean EcuMEnableDefBehaviour: set at pre-compile  # Switches the defensive behaviour on or off.
      boolean EcuMIncludeDem: set at pre-compile  # If enabled and NVRAM manager is disabled, then an error shall be flagged by the configuration tool
      boolean EcuMIncludeDet: set at pre-compile  # If defined, the according BSW module will be initialized by the ECU State Manager
      float EcuMMainFunctionPeriod: set at pre-compile  # This parameter defines the schedule period of EcuM_MainFunction. | Unit: [s]
      boolean EcuMVersionInfoApi: set at pre-compile  # Switches the version info API on or off
