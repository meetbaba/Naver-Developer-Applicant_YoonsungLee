AUTOSAR XML (schema 4-0-2)
package /ETASEVE/EcucDefs
  module definition Port [0..1]: refined-module-def=Port, variants post-build/pre-compile  # Configuration of the Port module.
    container PortConfigSet: multiple-configuration-container=true  # This container is the base of a multiple configuration set
      container PortContainer [1..*]  # Container collecting the PortPins.
        integer PortNumberOfPortPins: 1..65535, set at pre-compile  # The number of specified PortPins in this PortContainer.
        container PortPin [1..*]  # Configuration of the individual port pins.
          enumeration PortPinDirection: {PORT_PIN_IN, PORT_PIN_OUT}, set at post-build in variant post-build / pre-compile in variant pre-compile  # The initial direction of the pin (IN or OUT). If the direction is not changeable, the value configured here is fixed. | The direction must match the pin mode. E.g. a pin used for an ADC must be configured to be an in port. Implementation Type: Port_PinDirectionType
          boolean PortPinDirectionChangeable: set at post-build in variant post-build / pre-compile in variant pre-compile  # Parameter to indicate if the direction is changeable on a port pin during runtime. | true: Port Pin direction changeable enabled. false: Port Pin direction changeable disabled.
          integer PortPinId: 1..65535, set at pre-compile, symbolic-name-value=true  # Pin Id of the port pin. This value will be assigned to the symbolic name derived from the port pin container short name.
          enumeration PortPinInitialMode: {PORT_PIN_MODE_ADC, PORT_PIN_MODE_CAN, PORT_PIN_MODE_DIO, PORT_PIN_MODE_DIO_GPT, PORT_PIN_MODE_DIO_WDG, PORT_PIN_MODE_FLEXRAY, PORT_PIN_MODE_ICU, PORT_PIN_MODE_LIN, PORT_PIN_MODE_MEM, PORT_PIN_MODE_PWM, PORT_PIN_MODE_SPI}, set at post-build in variant post-build / pre-compile in variant pre-compile  # Port pin mode from mode list for use with Port_Init() function.
          enumeration PortPinLevelValue: {PORT_PIN_LEVEL_HIGH, PORT_PIN_LEVEL_LOW}, set at post-build in variant post-build / pre-compile in variant pre-compile  # Port Pin Level value from Port pin list.
          enumeration PortPinMode [1..*]: {PORT_PIN_MODE_ADC, PORT_PIN_MODE_CAN, PORT_PIN_MODE_DIO, PORT_PIN_MODE_DIO_GPT, PORT_PIN_MODE_DIO_WDG, PORT_PIN_MODE_FLEXRAY, PORT_PIN_MODE_ICU, PORT_PIN_MODE_LIN, PORT_PIN_MODE_MEM, PORT_PIN_MODE_PWM, PORT_PIN_MODE_SPI}, set at post-build in variant post-build / pre-compile in variant pre-compile  # Port pin mode from mode list. | Note that more than one mode is allowed by default. That way it is e.g. possible to combine DIO with another mode such as ICU. More HW specific literals may be added by module implementor. E.g. SPI may be further broken down into SpiCsHw, SpiCsSw, etc. if necessary.
          boolean PortPinModeChangeable: set at post-build in variant post-build / pre-compile in variant pre-compile  # Parameter to indicate if the mode is changeable on a port pin during runtime. True: Port Pin mode changeable allowed. False: Port Pin mode changeable not permitted.
          container Port_VapPinConfiguration
            integer PcieCardInstance: set at pre-compile, default-value=1  # Instance of the PcieCard
            integer PcieCardPinMode: set at pre-compile, default-value=1  # Card Pin mode to be initialized in Port_Init()
            enumeration PcieCardId: {ES5340, OTHERS}, set at post-build in variant post-build / pre-compile in variant pre-compile  # Pcie Card ID from the list
            enumeration PcieCardPinNumber: {PORT_ES5340_PIN_ANA_OUT0, PORT_ES5340_PIN_ANA_OUT1, PORT_ES5340_PIN_ANA_OUT2, PORT_ES5340_PIN_ANA_OUT3, PORT_ES5340_PIN_ANA_OUT4, PORT_ES5340_PIN_ANA_OUT5, PORT_ES5340_PIN_ANA_OUT6, PORT_ES5340_PIN_ANA_OUT7, PORT_ES5340_PIN_DIO_OUT0, PORT_ES5340_PIN_DIO_OUT1, PORT_ES5340_PIN_DIO_OUT2, PORT_ES5340_PIN_DIO_OUT3, PORT_ES5340_PIN_DIO_OUT4, PORT_ES5340_PIN_DIO_OUT5, PORT_ES5340_PIN_DIO_OUT6, PORT_ES5340_PIN_DIO_OUT7, PORT_ES5340_PIN_DIO_IN0, PORT_ES5340_PIN_DIO_IN1, PORT_ES5340_PIN_DIO_IN2, PORT_ES5340_PIN_DIO_IN3, PORT_ES5340_PIN_DIO_IN4, PORT_ES5340_PIN_DIO_IN5, PORT_ES5340_PIN_DIO_IN6, PORT_ES5340_PIN_DIO_IN7, PORT_ES5340_PIN_DIO_IN8, PORT_ES5340_PIN_DIO_IN9, PORT_ES5340_PIN_DIO_IN10, PORT_ES5340_PIN_DIO_IN11, PORT_ES5340_PIN_DIO_IN12, PORT_ES5340_PIN_DIO_IN13, PORT_ES5340_PIN_DIO_IN14, PORT_ES5340_PIN_DIO_IN15, PORT_ES5340_PIN_DIO_IN16, PORT_ES5340_PIN_DIO_IN17, PORT_ES5340_PIN_DIO_IN18, PORT_ES5340_PIN_DIO_IN19, PORT_ES5340_PIN_ANA_IN0, PORT_ES5340_PIN_ANA_IN1, PORT_ES5340_PIN_ANA_IN2, PORT_ES5340_PIN_ANA_IN3}, set at post-build in variant post-build / pre-compile in variant pre-compile  # Card Pin number of ES5340 card pins
            integer PcieCardPortId: set at pre-compile, default-value=1  # Port in the card to which the card pin belongs
            choice reference ModuleRefernce: set at link in variant link-time / pre-compile in variant pre-compile  # This is a choice reference to the module to which the pin belongs.
    container PortGeneral  # Module wide configuration parameters of the PORT driver.
      boolean PortDevErrorDetect: set at pre-compile  # Switches the Development Error Detection and Notification on or off. | true: Enabled. false: Disabled.
      boolean PortSetPinDirectionApi: set at pre-compile  # Pre-processor switch to enable / disable the use of the function Port_SetPinDirection(). | TRUE: Enabled - Function Port_SetPinDirection() is available. FALSE: Disabled - Function Port_SetPinDirection() is not available.
      boolean PortSetPinModeApi: set at pre-compile  # Pre-processor switch to enable / disable the use of the function Port_SetPinMode(). | true: Enabled - Function Port_SetPinMode() is available. false: Disabled - Function Port_SetPinMode() is not available.
      boolean PortVersionInfoApi: set at pre-compile  # Pre-processor switch to enable / disable the API to read out the modules version information. | true: Version info API enabled. false: Version info API disabled.
