/**
* \file
* \brief A2L fragment describing the configuration of a single XCP session.
* This file is generated by the driver's configuration script.
* Generated from config file "D:\develop\VAP\Examples\trunk\DemoCar-OneNode\FinalBuild\src\XCP\generated\xcp.xml" at 12:12:47 on 23/3/2012
* Copyright ETAS GmbH, Stuttgart.
* This file is covered by the licence and disclaimer document which is installed with
* the XCP ECU software package.
* \version $Id: if_data_xcp.a2lt 22395 2011-04-20 15:21:38Z olcritch $
******************************************************************************/
/* Un-comment these lines to create an A2L file suitable for importing into the Visu-IT! ASAP2 editor. */ ASAP2_VERSION 1 51
/begin PROJECT PrjName "PrjLongName"
/begin MODULE ModName "ModLongName"
/begin IF_DATA XCP /* Insert this block within the MODULE block of the A2L file. */
 /begin PROTOCOL_LAYER 0x0100 /* XCP protocol layer 1.0 */ 2000 /* T1 [ms] */ 2000 /* T2 [ms] */ 2000 /* T3 [ms] */ 2000 /* T4 [ms] */ 2000 /* T5 [ms] */ 0005 /* T6 [ms] */ 0005 /* T7 [ms] */ 0xff /* MAX_CTO */ 0x05bc /* MAX_DTO */ BYTE_ORDER_MSB_LAST ADDRESS_GRANULARITY_BYTE OPTIONAL_CMD SET_REQUEST OPTIONAL_CMD SET_MTA OPTIONAL_CMD UPLOAD OPTIONAL_CMD TRANSPORT_LAYER_CMD OPTIONAL_CMD CLEAR_DAQ_LIST OPTIONAL_CMD SET_DAQ_PTR OPTIONAL_CMD WRITE_DAQ OPTIONAL_CMD SET_DAQ_LIST_MODE OPTIONAL_CMD START_STOP_DAQ_LIST OPTIONAL_CMD START_STOP_SYNCH OPTIONAL_CMD GET_DAQ_CLOCK OPTIONAL_CMD MODIFY_BITS OPTIONAL_CMD DOWNLOAD OPTIONAL_CMD DOWNLOAD_NEXT OPTIONAL_CMD SET_CAL_PAGE OPTIONAL_CMD GET_CAL_PAGE OPTIONAL_CMD COPY_CAL_PAGE COMMUNICATION_MODE_SUPPORTED BLOCK SLAVE MASTER 0xff /* MAX_BS */ 100 /* MIN_ST */ /end PROTOCOL_LAYER
 /begin DAQ STATIC /* DAQ_CONFIG_TYPE */ 8 /* MAX_DAQ */ 8 /* MAX_EVENT_CHANNEL */ 0 /* MIN_DAQ, i.e. the number of predefined DAQ lists */ OPTIMISATION_TYPE_DEFAULT ADDRESS_EXTENSION_DAQ /* ADDR_EXTENSION_TYPE */ IDENTIFICATION_FIELD_TYPE_ABSOLUTE GRANULARITY_ODT_ENTRY_SIZE_DAQ_BYTE 127 /* MAX_ODT_ENTRY_SIZE_DAQ */ NO_OVERLOAD_INDICATION
  /begin TIMESTAMP_SUPPORTED 1 /* TIMESTAMP_TICKS */ SIZE_WORD /* TIMESTAMP_SIZE */ UNIT_1MS /* TIMESTAMP_RESOLUTION */ /end TIMESTAMP_SUPPORTED
  /begin DAQ_LIST /* Event0 */ 0 DAQ_LIST_TYPE DAQ MAX_ODT 1 MAX_ODT_ENTRIES 255 FIRST_PID 0 EVENT_FIXED 0 /end DAQ_LIST
  /begin DAQ_LIST /* Event1 */ 1 DAQ_LIST_TYPE DAQ MAX_ODT 1 MAX_ODT_ENTRIES 255 FIRST_PID 1 EVENT_FIXED 1 /end DAQ_LIST
  /begin DAQ_LIST /* Event2 */ 2 DAQ_LIST_TYPE DAQ MAX_ODT 1 MAX_ODT_ENTRIES 255 FIRST_PID 2 EVENT_FIXED 2 /end DAQ_LIST
  /begin DAQ_LIST /* Event3 */ 3 DAQ_LIST_TYPE DAQ MAX_ODT 1 MAX_ODT_ENTRIES 255 FIRST_PID 3 EVENT_FIXED 3 /end DAQ_LIST
  /begin DAQ_LIST /* Event4 */ 4 DAQ_LIST_TYPE DAQ MAX_ODT 1 MAX_ODT_ENTRIES 255 FIRST_PID 4 EVENT_FIXED 4 /end DAQ_LIST
  /begin DAQ_LIST /* Event5 */ 5 DAQ_LIST_TYPE DAQ MAX_ODT 1 MAX_ODT_ENTRIES 255 FIRST_PID 5 EVENT_FIXED 5 /end DAQ_LIST
  /begin DAQ_LIST /* Event6 */ 6 DAQ_LIST_TYPE DAQ MAX_ODT 1 MAX_ODT_ENTRIES 255 FIRST_PID 6 EVENT_FIXED 6 /end DAQ_LIST
  /begin DAQ_LIST /* Event7 */ 7 DAQ_LIST_TYPE DAQ MAX_ODT 1 MAX_ODT_ENTRIES 255 FIRST_PID 7 EVENT_FIXED 7 /end DAQ_LIST
  /begin EVENT "Event0" "Event0" 0 DAQ_STIM 0xff 0 6 0 /end EVENT
  /begin EVENT "Event1" "Event1" 1 DAQ_STIM 0xff 0 6 0 /end EVENT
  /begin EVENT "Event2" "Event2" 2 DAQ_STIM 0xff 0 6 0 /end EVENT
  /begin EVENT "Event3" "Event3" 3 DAQ_STIM 0xff 0 6 0 /end EVENT
  /begin EVENT "Event4" "Event4" 4 DAQ_STIM 0xff 0 6 0 /end EVENT
  /begin EVENT "Event5" "Event5" 5 DAQ_STIM 0xff 0 6 0 /end EVENT
  /begin EVENT "Event6" "Event6" 6 DAQ_STIM 0xff 0 6 0 /end EVENT
  /begin EVENT "Event7" "Event7" 7 DAQ_STIM 0xff 0 6 0 /end EVENT
 /end DAQ
 /begin PAG 1 /* MAX_SEGMENTS */ FREEZE_SUPPORTED /end PAG
 /begin PGM PGM_MODE_ABSOLUTE 0 /* MAX_SECTORS */ 0x08 /* MAX_CTO_PGM */ COMMUNICATION_MODE_SUPPORTED BLOCK SLAVE MASTER 0xff /* MAX_BS_PGM */ 100 /* MIN_ST_PGM */ /end PGM
 /begin XCP_ON_UDP_IP 0x0100 /* XCP on IP 1.0 */ "<UDPPORT>" /* Port */ ADDRESS "<IPADDR>" /end XCP_ON_UDP_IP
/end IF_DATA
/* Un-comment these lines to create an A2L file suitable for importing into the Visu-IT! ASAP2 editor. */
/end MODULE
/end PROJECT
