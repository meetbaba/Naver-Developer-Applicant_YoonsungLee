AUTOSAR XML (schema 4-0-2)
standard types defined: float32, uint8
package /AUTOSAR_Rte/BswModuleDescriptions
  bsw module description RteBswModuleDescription: provided-entrys=[Rte_Start, Rte_Stop, SchM_DeInit, SchM_Init]
    bsw module dependency ModDepOS: target-module-id=001
      required-entrys:
        ActivateTask
        CancelAlarm
        ChainTask
        ClearEvent
        GetEvent
        GetResource
        GetTaskID
        ReleaseResource
        ResumeOSInterrupts
        SetEvent
        SetRelAlarm
        SuspendOSInterrupts
        TerminateTask
        WaitEvent
    bsw internal behavior RteInternalBehavior
      constant-memorys:
        29 x parameter data prototype:
          Rte_Queue_SwComponentPrototype_CoolantTemperaturePlausi_PPortCTRAW_SetCoolantTemperatureRaw: type=Rte_QREType
          Rte_Queue_SwComponentPrototype_CrankshaftPositionPlausi_PPortCPRAW_SetCrankshaftPositionRaw: type=Rte_QREType
          Rte_Queue_SwComponentPrototype_EngineECU_PPortSetFuelCutState_SetFuelCutState: type=Rte_QTaskType
          Rte_Queue_SwComponentPrototype_EngineECU_RPortAccelerate_SetAccelerateLevel: type=Rte_QDRAType
          Rte_Queue_SwComponentPrototype_EngineECU_RPortBrake_SetBrakeLevel: type=Rte_QDRAType
          Rte_Queue_SwComponentPrototype_EngineECU_RPortCPRAW_SetCrankshaftPositionRaw: type=Rte_QDRAType
          Rte_Queue_SwComponentPrototype_EngineECU_RPortCTRAW_SetCoolantTemperatureRaw: type=Rte_QDRAType
          Rte_Queue_SwComponentPrototype_EngineECU_RPortGear_SetGearLevel: type=Rte_QDRAType
          Rte_Queue_SwComponentPrototype_EngineECU_RPortGyroRAW_SetGyroRaw: type=Rte_QDRAType
          Rte_Queue_SwComponentPrototype_EngineECU_RPortVSRAW_SetVehicleSpeedRaw: type=Rte_QDRAType
          Rte_Queue_SwComponentPrototype_FuelCutActuator_RPortSetFuelCutState_SetFuelCutState: type=Rte_QDRAType
          Rte_Queue_SwComponentPrototype_FuelCutAlgo_PPortAccelerate_SetAccelerateLevel: type=Rte_QREType
          Rte_Queue_SwComponentPrototype_FuelCutAlgo_PPortBrake_SetBrakeLevel: type=Rte_QREType
          Rte_Queue_SwComponentPrototype_FuelCutAlgo_PPortGear_SetGearLevel: type=Rte_QREType
          Rte_Queue_SwComponentPrototype_GyroPlausi_PPortGyroRAW_SetGyroRaw: type=Rte_QREType
          Rte_Queue_SwComponentPrototype_VehicleSpeedPlausi_PPortVSRAW_SetVehicleSpeedRaw: type=Rte_QREType
          Rte_RE_CONTAINER_SwComponentPrototype_CoolantTemperaturePlausi_OIE_SetCoolantTemperatureRaw: type=Rte_REContainerType
          Rte_RE_CONTAINER_SwComponentPrototype_CrankshaftPositionPlausi_OIE_SetCrankshaftPositionRaw: type=Rte_REContainerType
          Rte_RE_CONTAINER_SwComponentPrototype_FuelCutAlgo_DRE_CoolantTempertaturePls: type=Rte_REContainerType
          Rte_RE_CONTAINER_SwComponentPrototype_FuelCutAlgo_DRE_CrankshaftPositionPls: type=Rte_REContainerType
          Rte_RE_CONTAINER_SwComponentPrototype_FuelCutAlgo_DRE_GyroPls: type=Rte_REContainerType
          Rte_RE_CONTAINER_SwComponentPrototype_FuelCutAlgo_DRE_VehicleSpeedPls: type=Rte_REContainerType
          Rte_RE_CONTAINER_SwComponentPrototype_FuelCutAlgo_OIE_SetAccelerateLevel: type=Rte_REContainerType
          Rte_RE_CONTAINER_SwComponentPrototype_FuelCutAlgo_OIE_SetBrakeLevel: type=Rte_REContainerType
          Rte_RE_CONTAINER_SwComponentPrototype_FuelCutAlgo_OIE_SetGearLevel: type=Rte_REContainerType
          Rte_RE_CONTAINER_SwComponentPrototype_GyroPlausi_OIE_SetGyroRaw: type=Rte_REContainerType
          Rte_RE_CONTAINER_SwComponentPrototype_VehicleSpeedPlausi_OIE_SetVehicleSpeedRaw: type=Rte_REContainerType
          Rte_Tasks: type=Rte_TaskInfo
          Rte_TimeoutAlarms: type=Rte_AlarmRefType
      static-memorys:
        65 x data:
          Rte_ActCount_SwComponentPrototype_CoolantTemperaturePlausi_OIE_SetCoolantTemperatureRaw: type=Rte_REActCounterType
          Rte_ActCount_SwComponentPrototype_CrankshaftPositionPlausi_OIE_SetCrankshaftPositionRaw: type=Rte_REActCounterType
          Rte_ActCount_SwComponentPrototype_FuelCutAlgo_DRE_CoolantTempertaturePls: type=Rte_REActCounterType
          Rte_ActCount_SwComponentPrototype_FuelCutAlgo_DRE_CrankshaftPositionPls: type=Rte_REActCounterType
          Rte_ActCount_SwComponentPrototype_FuelCutAlgo_DRE_GyroPls: type=Rte_REActCounterType
          Rte_ActCount_SwComponentPrototype_FuelCutAlgo_DRE_VehicleSpeedPls: type=Rte_REActCounterType
          Rte_ActCount_SwComponentPrototype_FuelCutAlgo_OIE_SetAccelerateLevel: type=Rte_REActCounterType
          Rte_ActCount_SwComponentPrototype_FuelCutAlgo_OIE_SetBrakeLevel: type=Rte_REActCounterType
          Rte_ActCount_SwComponentPrototype_FuelCutAlgo_OIE_SetGearLevel: type=Rte_REActCounterType
          Rte_ActCount_SwComponentPrototype_GyroPlausi_OIE_SetGyroRaw: type=Rte_REActCounterType
          Rte_ActCount_SwComponentPrototype_VehicleSpeedPlausi_OIE_SetVehicleSpeedRaw: type=Rte_REActCounterType
          Rte_ImplicitBufs: type=Rte_ImplicitBufsType
          Rte_Queue_SwComponentPrototype_CoolantTemperaturePlausi_PPortCTRAW_SetCoolantTemperatureRaw_data: type=Rte_SwComponentPrototype_CoolantTemperaturePlausi_PPortCTRAW_SetCoolantTemperatureRaw_QEType
          Rte_Queue_SwComponentPrototype_CoolantTemperaturePlausi_PPortCTRAW_SetCoolantTemperatureRaw_dyn: type=Rte_QDynType
          Rte_Queue_SwComponentPrototype_CrankshaftPositionPlausi_PPortCPRAW_SetCrankshaftPositionRaw_data: type=Rte_SwComponentPrototype_CrankshaftPositionPlausi_PPortCPRAW_SetCrankshaftPositionRaw_QEType
          Rte_Queue_SwComponentPrototype_CrankshaftPositionPlausi_PPortCPRAW_SetCrankshaftPositionRaw_dyn: type=Rte_QDynType
          Rte_Queue_SwComponentPrototype_EngineECU_PPortSetFuelCutState_SetFuelCutState_data: type=Rte_SwComponentPrototype_EngineECU_PPortSetFuelCutState_SetFuelCutState_QEType
          Rte_Queue_SwComponentPrototype_EngineECU_PPortSetFuelCutState_SetFuelCutState_dyn: type=Rte_QDynType
          Rte_Queue_SwComponentPrototype_EngineECU_RPortAccelerate_SetAccelerateLevel_data: type=Rte_SwComponentPrototype_FuelCutAlgo_PPortAccelerate_SetAccelerateLevel_RtnQEType
          Rte_Queue_SwComponentPrototype_EngineECU_RPortAccelerate_SetAccelerateLevel_dynamic: type=Rte_QDynType
          Rte_Queue_SwComponentPrototype_EngineECU_RPortBrake_SetBrakeLevel_data: type=Rte_SwComponentPrototype_FuelCutAlgo_PPortBrake_SetBrakeLevel_RtnQEType
          Rte_Queue_SwComponentPrototype_EngineECU_RPortBrake_SetBrakeLevel_dynamic: type=Rte_QDynType
          Rte_Queue_SwComponentPrototype_EngineECU_RPortCPRAW_SetCrankshaftPositionRaw_data: type=Rte_SwComponentPrototype_CrankshaftPositionPlausi_PPortCPRAW_SetCrankshaftPositionRaw_RtnQEType
          Rte_Queue_SwComponentPrototype_EngineECU_RPortCPRAW_SetCrankshaftPositionRaw_dynamic: type=Rte_QDynType
          Rte_Queue_SwComponentPrototype_EngineECU_RPortCTRAW_SetCoolantTemperatureRaw_data: type=Rte_SwComponentPrototype_CoolantTemperaturePlausi_PPortCTRAW_SetCoolantTemperatureRaw_RtnQEType
          Rte_Queue_SwComponentPrototype_EngineECU_RPortCTRAW_SetCoolantTemperatureRaw_dynamic: type=Rte_QDynType
          Rte_Queue_SwComponentPrototype_EngineECU_RPortGear_SetGearLevel_data: type=Rte_SwComponentPrototype_FuelCutAlgo_PPortGear_SetGearLevel_RtnQEType
          Rte_Queue_SwComponentPrototype_EngineECU_RPortGear_SetGearLevel_dynamic: type=Rte_QDynType
          Rte_Queue_SwComponentPrototype_EngineECU_RPortGyroRAW_SetGyroRaw_data: type=Rte_SwComponentPrototype_GyroPlausi_PPortGyroRAW_SetGyroRaw_RtnQEType
          Rte_Queue_SwComponentPrototype_EngineECU_RPortGyroRAW_SetGyroRaw_dynamic: type=Rte_QDynType
          Rte_Queue_SwComponentPrototype_EngineECU_RPortVSRAW_SetVehicleSpeedRaw_data: type=Rte_SwComponentPrototype_VehicleSpeedPlausi_PPortVSRAW_SetVehicleSpeedRaw_RtnQEType
          Rte_Queue_SwComponentPrototype_EngineECU_RPortVSRAW_SetVehicleSpeedRaw_dynamic: type=Rte_QDynType
          Rte_Queue_SwComponentPrototype_FuelCutActuator_RPortSetFuelCutState_SetFuelCutState_data: type=Rte_SwComponentPrototype_EngineECU_PPortSetFuelCutState_SetFuelCutState_RtnQEType
          Rte_Queue_SwComponentPrototype_FuelCutActuator_RPortSetFuelCutState_SetFuelCutState_dynamic: type=Rte_QDynType
          Rte_Queue_SwComponentPrototype_FuelCutAlgo_PPortAccelerate_SetAccelerateLevel_data: type=Rte_SwComponentPrototype_FuelCutAlgo_PPortAccelerate_SetAccelerateLevel_QEType
          Rte_Queue_SwComponentPrototype_FuelCutAlgo_PPortAccelerate_SetAccelerateLevel_dyn: type=Rte_QDynType
          Rte_Queue_SwComponentPrototype_FuelCutAlgo_PPortBrake_SetBrakeLevel_data: type=Rte_SwComponentPrototype_FuelCutAlgo_PPortBrake_SetBrakeLevel_QEType
          Rte_Queue_SwComponentPrototype_FuelCutAlgo_PPortBrake_SetBrakeLevel_dyn: type=Rte_QDynType
          Rte_Queue_SwComponentPrototype_FuelCutAlgo_PPortGear_SetGearLevel_data: type=Rte_SwComponentPrototype_FuelCutAlgo_PPortGear_SetGearLevel_QEType
          Rte_Queue_SwComponentPrototype_FuelCutAlgo_PPortGear_SetGearLevel_dyn: type=Rte_QDynType
          Rte_Queue_SwComponentPrototype_GyroPlausi_PPortGyroRAW_SetGyroRaw_data: type=Rte_SwComponentPrototype_GyroPlausi_PPortGyroRAW_SetGyroRaw_QEType
          Rte_Queue_SwComponentPrototype_GyroPlausi_PPortGyroRAW_SetGyroRaw_dyn: type=Rte_QDynType
          Rte_Queue_SwComponentPrototype_VehicleSpeedPlausi_PPortVSRAW_SetVehicleSpeedRaw_data: type=Rte_SwComponentPrototype_VehicleSpeedPlausi_PPortVSRAW_SetVehicleSpeedRaw_QEType
          Rte_Queue_SwComponentPrototype_VehicleSpeedPlausi_PPortVSRAW_SetVehicleSpeedRaw_dyn: type=Rte_QDynType
          Rte_Var_SwComponentPrototype_EngineECU_RPortAccelerate_SetAccelerateLevel_outstanding: type=uint8
          Rte_Var_SwComponentPrototype_EngineECU_RPortBrake_SetBrakeLevel_outstanding: type=uint8
          Rte_Var_SwComponentPrototype_EngineECU_RPortCPRAW_SetCrankshaftPositionRaw_outstanding: type=uint8
          Rte_Var_SwComponentPrototype_EngineECU_RPortCTRAW_SetCoolantTemperatureRaw_outstanding: type=uint8
          Rte_Var_SwComponentPrototype_EngineECU_RPortGear_SetGearLevel_outstanding: type=uint8
          Rte_Var_SwComponentPrototype_EngineECU_RPortGyroRAW_SetGyroRaw_outstanding: type=uint8
          Rte_Var_SwComponentPrototype_EngineECU_RPortVSRAW_SetVehicleSpeedRaw_outstanding: type=uint8
          Rte_Var_SwComponentPrototype_FuelCutActuator_RPortSetFuelCutState_SetFuelCutState_outstanding: type=uint8
          SwComponentPrototype_EngineECU_IB_EngineECU_eX_FuelCutState: type=uint8
          SwComponentPrototype_FuelCutAlgo_IB_FuelCutAlgo_eX_AccelerateLevel: type=uint8
          SwComponentPrototype_FuelCutAlgo_IB_FuelCutAlgo_eX_BrakeLevel: type=uint8
          SwComponentPrototype_FuelCutAlgo_IB_FuelCutAlgo_eX_CoolantTemperature: type=float32
          SwComponentPrototype_FuelCutAlgo_IB_FuelCutAlgo_eX_CrankshaftPosition: type=float32
          SwComponentPrototype_FuelCutAlgo_IB_FuelCutAlgo_eX_GearLevel: type=uint8
          SwComponentPrototype_FuelCutAlgo_IB_FuelCutAlgo_eX_Gyro: type=float32
          SwComponentPrototype_FuelCutAlgo_IB_FuelCutAlgo_eX_VehicleSpeed: type=float32
          coolantTemperature_pls: type=float32
          crankshaftPosition_pls: type=float32
          fuelCutAction: type=uint8
          gyro_pls: type=float32
          vehicleSpeed_pls: type=float32
      4 x bsw called entity:
        BCERte_Start: implemented-entry=Rte_Start
        BCERte_Stop: implemented-entry=Rte_Stop
        BCESchM_DeInit: implemented-entry=SchM_DeInit
        BCESchM_Init: implemented-entry=SchM_Init
package /AUTOSAR_Rte/BswModuleEntrys
  4 x bsw module entry:
    Rte_Start
    Rte_Stop
    SchM_DeInit
    SchM_Init
package /AUTOSAR_Rte/BswImplementations
  bsw implementation Imp: programming-language=C, sw-version=0.0.0, used-code-generator=ETAS RTEGen, ar-release-version=4.0.0, behavior=RteInternalBehavior
    generated-artifacts:
      43 x dependency on artifact:
        Com_h: artifact-descriptor={short-label=Com_h, category=SWHDR, domain=AUTOSAR}
        CoolantTemperaturePlausi_MemMap_h: artifact-descriptor={short-label=CoolantTemperaturePlausi_MemMap_h, category=SWHDR, domain=AUTOSAR}
        CrankshaftPositionPlausi_MemMap_h: artifact-descriptor={short-label=CrankshaftPositionPlausi_MemMap_h, category=SWHDR, domain=AUTOSAR}
        EngineECU_MemMap_h: artifact-descriptor={short-label=EngineECU_MemMap_h, category=SWHDR, domain=AUTOSAR}
        FuelCutActuator_MemMap_h: artifact-descriptor={short-label=FuelCutActuator_MemMap_h, category=SWHDR, domain=AUTOSAR}
        FuelCutAlgo_MemMap_h: artifact-descriptor={short-label=FuelCutAlgo_MemMap_h, category=SWHDR, domain=AUTOSAR}
        GyroPlausi_MemMap_h: artifact-descriptor={short-label=GyroPlausi_MemMap_h, category=SWHDR, domain=AUTOSAR}
        Ioc_h: artifact-descriptor={short-label=Ioc_h, category=SWHDR, domain=AUTOSAR}
        MemMap_h: artifact-descriptor={short-label=MemMap_h, category=SWHDR, domain=AUTOSAR}
        NvM_h: artifact-descriptor={short-label=NvM_h, category=SWHDR, domain=AUTOSAR}
        Os_h: artifact-descriptor={short-label=Os_h, category=SWHDR, domain=AUTOSAR}
        OsTask_ActuatorToEngine_h: artifact-descriptor={short-label=OsTask_ActuatorToEngine_h, category=SWHDR, domain=AUTOSAR}
        OsTask_Algo_h: artifact-descriptor={short-label=OsTask_Algo_h, category=SWHDR, domain=AUTOSAR}
        OsTask_AlgoToActuator_h: artifact-descriptor={short-label=OsTask_AlgoToActuator_h, category=SWHDR, domain=AUTOSAR}
        OsTask_ECU_h: artifact-descriptor={short-label=OsTask_ECU_h, category=SWHDR, domain=AUTOSAR}
        OsTask_Plausi_h: artifact-descriptor={short-label=OsTask_Plausi_h, category=SWHDR, domain=AUTOSAR}
        OsTask_SetFuelCutState_h: artifact-descriptor={short-label=OsTask_SetFuelCutState_h, category=SWHDR, domain=AUTOSAR}
        Rte_c: artifact-descriptor={short-label=Rte_c, category=SWSRC, domain=AUTOSAR}
        Rte_h: artifact-descriptor={short-label=Rte_h, category=SWHDR, domain=AUTOSAR}
        Rte_Cbk_h: artifact-descriptor={short-label=Rte_Cbk_h, category=SWHDR, domain=AUTOSAR}
        Rte_Cfg_h: artifact-descriptor={short-label=Rte_Cfg_h, category=SWHDR, domain=AUTOSAR}
        Rte_Const_h: artifact-descriptor={short-label=Rte_Const_h, category=SWHDR, domain=AUTOSAR}
        Rte_CoolantTemperaturePlausi_h: artifact-descriptor={short-label=Rte_CoolantTemperaturePlausi_h, category=SWHDR, domain=AUTOSAR}
        Rte_CoolantTemperaturePlausi_Type_h: artifact-descriptor={short-label=Rte_CoolantTemperaturePlausi_Type_h, category=SWHDR, domain=AUTOSAR}
        Rte_CrankshaftPositionPlausi_h: artifact-descriptor={short-label=Rte_CrankshaftPositionPlausi_h, category=SWHDR, domain=AUTOSAR}
        Rte_CrankshaftPositionPlausi_Type_h: artifact-descriptor={short-label=Rte_CrankshaftPositionPlausi_Type_h, category=SWHDR, domain=AUTOSAR}
        Rte_DataHandleType_h: artifact-descriptor={short-label=Rte_DataHandleType_h, category=SWHDR, domain=AUTOSAR}
        Rte_EngineECU_h: artifact-descriptor={short-label=Rte_EngineECU_h, category=SWHDR, domain=AUTOSAR}
        Rte_EngineECU_Type_h: artifact-descriptor={short-label=Rte_EngineECU_Type_h, category=SWHDR, domain=AUTOSAR}
        Rte_FuelCutActuator_h: artifact-descriptor={short-label=Rte_FuelCutActuator_h, category=SWHDR, domain=AUTOSAR}
        Rte_FuelCutActuator_Type_h: artifact-descriptor={short-label=Rte_FuelCutActuator_Type_h, category=SWHDR, domain=AUTOSAR}
        Rte_FuelCutAlgo_h: artifact-descriptor={short-label=Rte_FuelCutAlgo_h, category=SWHDR, domain=AUTOSAR}
        Rte_FuelCutAlgo_Type_h: artifact-descriptor={short-label=Rte_FuelCutAlgo_Type_h, category=SWHDR, domain=AUTOSAR}
        Rte_GyroPlausi_h: artifact-descriptor={short-label=Rte_GyroPlausi_h, category=SWHDR, domain=AUTOSAR}
        Rte_GyroPlausi_Type_h: artifact-descriptor={short-label=Rte_GyroPlausi_Type_h, category=SWHDR, domain=AUTOSAR}
        Rte_Hook_h: artifact-descriptor={short-label=Rte_Hook_h, category=SWHDR, domain=AUTOSAR}
        Rte_Intl_h: artifact-descriptor={short-label=Rte_Intl_h, category=SWHDR, domain=AUTOSAR}
        Rte_Lib_c: artifact-descriptor={short-label=Rte_Lib_c, category=SWSRC, domain=AUTOSAR}
        Rte_Main_h: artifact-descriptor={short-label=Rte_Main_h, category=SWHDR, domain=AUTOSAR}
        Rte_Type_h: artifact-descriptor={short-label=Rte_Type_h, category=SWHDR, domain=AUTOSAR}
        Rte_VehicleSpeedPlausi_h: artifact-descriptor={short-label=Rte_VehicleSpeedPlausi_h, category=SWHDR, domain=AUTOSAR}
        Rte_VehicleSpeedPlausi_Type_h: artifact-descriptor={short-label=Rte_VehicleSpeedPlausi_Type_h, category=SWHDR, domain=AUTOSAR}
        VehicleSpeedPlausi_MemMap_h: artifact-descriptor={short-label=VehicleSpeedPlausi_MemMap_h, category=SWHDR, domain=AUTOSAR}
    resource consumption ResConsumption
      4 x memory section:
        CONST_UNSPECIFIED: alignment=UNSPECIFIED, sw-addrmethod=CONST_UNSPECIFIED
        VAR_32BIT: alignment=32, sw-addrmethod=VAR_32BIT
        VAR_8BIT: alignment=8, sw-addrmethod=VAR_8BIT
        VAR_UNSPECIFIED: alignment=UNSPECIFIED, sw-addrmethod=VAR_UNSPECIFIED
package /AUTOSAR_Rte/DataConstrs
  range AUTOSAR_PlatformTypes_DataConstrs_uint8: raw 0..255
package /AUTOSAR_Rte/ImplementationDataTypes
  36 x impl type:
    Rte_REActCounterType: category=VALUE  # This is an external type, i.e. it is declared in the Rte Library and not in the XML. RTEGen does not have any information about this type apart from its name.
    Rte_DE_float32: category=STRUCTURE
      element value: implementation-data-type=float32
    Rte_TDB_OsTask_Plausi: category=STRUCTURE
      4 x element, all with category=TYPE_REFERENCE, implementation-data-type=Rte_DE_float32:
        sbuf{0..3}
    Rte_ISA_2: category=STRUCTURE
      element _OsTask_Plausi: implementation-data-type=Rte_TDB_OsTask_Plausi
    Rte_TDB_OsTask_Algo: category=STRUCTURE
      4 x element, all with category=TYPE_REFERENCE, implementation-data-type=Rte_DE_float32:
        sbuf{0..3}
    Rte_ISA_3: category=STRUCTURE
      element _OsTask_Algo: implementation-data-type=Rte_TDB_OsTask_Algo
    Rte_DE_uint8: category=STRUCTURE
      element value: implementation-data-type=uint8
    Rte_TDB_OsTask_AlgoToActuator: category=STRUCTURE
      element sbuf0: implementation-data-type=Rte_DE_uint8
    Rte_ISA_4: category=STRUCTURE
      element _OsTask_AlgoToActuator: implementation-data-type=Rte_TDB_OsTask_AlgoToActuator
    Rte_TDB_OsTask_ActuatorToEngine: category=STRUCTURE
      element sbuf0: implementation-data-type=Rte_DE_uint8
    Rte_ISA_5: category=STRUCTURE
      element _OsTask_ActuatorToEngine: implementation-data-type=Rte_TDB_OsTask_ActuatorToEngine
    Rte_ImplicitBufsType: category=STRUCTURE
      4 x element, all with category=TYPE_REFERENCE:
        isa_{2..5}: implementation-data-type=Rte_ISA_{2..5}
    Rte_QREType: category=VALUE  # This is an external type, i.e. it is declared in the Rte Library and not in the XML. RTEGen does not have any information about this type apart from its name.
    Rte_QCmnRefType: category=VALUE  # This is an external type, i.e. it is declared in the Rte Library and not in the XML. RTEGen does not have any information about this type apart from its name.
    Rte_SwComponentPrototype_CoolantTemperaturePlausi_PPortCTRAW_SetCoolantTemperatureRaw_QEType: category=STRUCTURE
      element coolantTemperatureRaw: implementation-data-type=float32
      element clientQueue: category=VALUE  # This is an external type, i.e. it is declared in the Rte Library and not in the XML. RTEGen does not have any information about this type apart from its name.
    Rte_QDynType: category=VALUE  # This is an external type, i.e. it is declared in the Rte Library and not in the XML. RTEGen does not have any information about this type apart from its name.
    Rte_SwComponentPrototype_CrankshaftPositionPlausi_PPortCPRAW_SetCrankshaftPositionRaw_QEType: category=STRUCTURE
      element crankshaftPositionRaw: implementation-data-type=float32
      element clientQueue: category=VALUE  # This is an external type, i.e. it is declared in the Rte Library and not in the XML. RTEGen does not have any information about this type apart from its name.
    Rte_QTaskType: category=VALUE  # This is an external type, i.e. it is declared in the Rte Library and not in the XML. RTEGen does not have any information about this type apart from its name.
    Rte_SwComponentPrototype_EngineECU_PPortSetFuelCutState_SetFuelCutState_QEType: category=STRUCTURE
      element fuelCutState: implementation-data-type=uint8
      element clientQueue: category=VALUE  # This is an external type, i.e. it is declared in the Rte Library and not in the XML. RTEGen does not have any information about this type apart from its name.
    Rte_QDRAType: category=VALUE  # This is an external type, i.e. it is declared in the Rte Library and not in the XML. RTEGen does not have any information about this type apart from its name.
    Rte_SwComponentPrototype_FuelCutAlgo_PPortAccelerate_SetAccelerateLevel_RtnQEType: category=STRUCTURE
      element dummy: implementation-data-type=uint8
    Rte_SwComponentPrototype_FuelCutAlgo_PPortBrake_SetBrakeLevel_RtnQEType: category=STRUCTURE
      element dummy: implementation-data-type=uint8
    Rte_SwComponentPrototype_CrankshaftPositionPlausi_PPortCPRAW_SetCrankshaftPositionRaw_RtnQEType: category=STRUCTURE
      element dummy: implementation-data-type=uint8
    Rte_SwComponentPrototype_CoolantTemperaturePlausi_PPortCTRAW_SetCoolantTemperatureRaw_RtnQEType: category=STRUCTURE
      element dummy: implementation-data-type=uint8
    Rte_SwComponentPrototype_FuelCutAlgo_PPortGear_SetGearLevel_RtnQEType: category=STRUCTURE
      element dummy: implementation-data-type=uint8
    Rte_SwComponentPrototype_GyroPlausi_PPortGyroRAW_SetGyroRaw_RtnQEType: category=STRUCTURE
      element dummy: implementation-data-type=uint8
    Rte_SwComponentPrototype_VehicleSpeedPlausi_PPortVSRAW_SetVehicleSpeedRaw_RtnQEType: category=STRUCTURE
      element dummy: implementation-data-type=uint8
    Rte_SwComponentPrototype_EngineECU_PPortSetFuelCutState_SetFuelCutState_RtnQEType: category=STRUCTURE
      element dummy: implementation-data-type=uint8
    Rte_SwComponentPrototype_FuelCutAlgo_PPortAccelerate_SetAccelerateLevel_QEType: category=STRUCTURE
      element accelerateLevel: implementation-data-type=uint8
      element clientQueue: category=VALUE  # This is an external type, i.e. it is declared in the Rte Library and not in the XML. RTEGen does not have any information about this type apart from its name.
    Rte_SwComponentPrototype_FuelCutAlgo_PPortBrake_SetBrakeLevel_QEType: category=STRUCTURE
      element brakeLevel: implementation-data-type=uint8
      element clientQueue: category=VALUE  # This is an external type, i.e. it is declared in the Rte Library and not in the XML. RTEGen does not have any information about this type apart from its name.
    Rte_SwComponentPrototype_FuelCutAlgo_PPortGear_SetGearLevel_QEType: category=STRUCTURE
      element gearLevel: implementation-data-type=uint8
      element clientQueue: category=VALUE  # This is an external type, i.e. it is declared in the Rte Library and not in the XML. RTEGen does not have any information about this type apart from its name.
    Rte_SwComponentPrototype_GyroPlausi_PPortGyroRAW_SetGyroRaw_QEType: category=STRUCTURE
      element gyroRaw: implementation-data-type=float32
      element clientQueue: category=VALUE  # This is an external type, i.e. it is declared in the Rte Library and not in the XML. RTEGen does not have any information about this type apart from its name.
    Rte_SwComponentPrototype_VehicleSpeedPlausi_PPortVSRAW_SetVehicleSpeedRaw_QEType: category=STRUCTURE
      element vehicleSpeedRaw: implementation-data-type=float32
      element clientQueue: category=VALUE  # This is an external type, i.e. it is declared in the Rte Library and not in the XML. RTEGen does not have any information about this type apart from its name.
    Rte_REContainerType: category=VALUE  # This is an external type, i.e. it is declared in the Rte Library and not in the XML. RTEGen does not have any information about this type apart from its name.
    Rte_TaskInfo: category=VALUE  # This is an external type, i.e. it is declared in the Rte Library and not in the XML. RTEGen does not have any information about this type apart from its name.
    Rte_AlarmRefType: category=VALUE  # This is an external type, i.e. it is declared in the Rte Library and not in the XML. RTEGen does not have any information about this type apart from its name.
package /AUTOSAR_Rte/SwAddrMethods
  4 x sw addr method:
    CONST_UNSPECIFIED: section-type=CONST
    VAR_32BIT: section-type=VAR
    VAR_8BIT: section-type=VAR
    VAR_UNSPECIFIED: section-type=VAR
