AUTOSAR XML (schema 4-0-3)
package /Os_Task
  module config Os_Task: definition=Os
    RTE_RESOURCE (OsResource): OsResourceProperty=STANDARD
    6 x OsTask, all with OsTaskSchedule=FULL, OsTaskResourceRef=RTE_RESOURCE:
      OsTask_ECU: OsTaskActivation=1, OsTaskPriority=1
      OsTask_Plausi: OsTaskActivation=12, OsTaskPriority=2
      OsTask_Algo: OsTaskActivation=13, OsTaskPriority=3
      OsTask_AlgoToActuator: OsTaskActivation=1, OsTaskPriority=4
      OsTask_ActuatorToEngine: OsTaskActivation=1, OsTaskPriority=5
      OsTask_SetFuelCutState: OsTaskActivation=3, OsTaskPriority=6
    Rte_TickCounter (OsCounter): OsCounterMaxAllowedValue=65535, OsCounterMinCycle=1, OsCounterTicksPerBase=1, OsCounterType=SOFTWARE
    Rte_ScheduleTable (OsScheduleTable): OsScheduleTableRepeating=true, OsScheduleTableDuration=10, OsScheduleTableCounterRef=Rte_TickCounter
      10 x OsScheduleTableExpiryPoint:
        rte_Stimulus_1: OsScheduleTblExpPointOffset=0
          TaskActivation1 (OsScheduleTableTaskActivation): OsScheduleTableActivateTaskRef=OsTask_AlgoToActuator
          TaskActivation2 (OsScheduleTableTaskActivation): OsScheduleTableActivateTaskRef=OsTask_ECU
        rte_Stimulus_2: OsScheduleTblExpPointOffset=1
          TaskActivation1 (OsScheduleTableTaskActivation): OsScheduleTableActivateTaskRef=OsTask_AlgoToActuator
        rte_Stimulus_3: OsScheduleTblExpPointOffset=2
          TaskActivation1 (OsScheduleTableTaskActivation): OsScheduleTableActivateTaskRef=OsTask_AlgoToActuator
        rte_Stimulus_4: OsScheduleTblExpPointOffset=3
          TaskActivation1 (OsScheduleTableTaskActivation): OsScheduleTableActivateTaskRef=OsTask_AlgoToActuator
        rte_Stimulus_5: OsScheduleTblExpPointOffset=4
          TaskActivation1 (OsScheduleTableTaskActivation): OsScheduleTableActivateTaskRef=OsTask_AlgoToActuator
        rte_Stimulus_6: OsScheduleTblExpPointOffset=5
          TaskActivation1 (OsScheduleTableTaskActivation): OsScheduleTableActivateTaskRef=OsTask_AlgoToActuator
        rte_Stimulus_7: OsScheduleTblExpPointOffset=6
          TaskActivation1 (OsScheduleTableTaskActivation): OsScheduleTableActivateTaskRef=OsTask_AlgoToActuator
        rte_Stimulus_8: OsScheduleTblExpPointOffset=7
          TaskActivation1 (OsScheduleTableTaskActivation): OsScheduleTableActivateTaskRef=OsTask_AlgoToActuator
        rte_Stimulus_9: OsScheduleTblExpPointOffset=8
          TaskActivation1 (OsScheduleTableTaskActivation): OsScheduleTableActivateTaskRef=OsTask_AlgoToActuator
        rte_Stimulus_10: OsScheduleTblExpPointOffset=9
          TaskActivation1 (OsScheduleTableTaskActivation): OsScheduleTableActivateTaskRef=OsTask_AlgoToActuator
    Rte_TOutCounter (OsCounter): OsCounterMaxAllowedValue=65535, OsCounterMinCycle=1, OsCounterTicksPerBase=1, OsCounterType=SOFTWARE
    8 x OsAlarm, all with OsAlarmCounterRef=Rte_TOutCounter:
      Rte_TimeoutAlarm1
        Action (OsAlarmAction)
          Callback (OsAlarmCallback): OsAlarmCallbackName=Rte_NullAlarmCallback
      Rte_TimeoutAlarm2
        Action (OsAlarmAction)
          Callback (OsAlarmCallback): OsAlarmCallbackName=Rte_NullAlarmCallback
      Rte_TimeoutAlarm3
        Action (OsAlarmAction)
          Callback (OsAlarmCallback): OsAlarmCallbackName=Rte_NullAlarmCallback
      Rte_TimeoutAlarm4
        Action (OsAlarmAction)
          Callback (OsAlarmCallback): OsAlarmCallbackName=Rte_NullAlarmCallback
      Rte_TimeoutAlarm5
        Action (OsAlarmAction)
          Callback (OsAlarmCallback): OsAlarmCallbackName=Rte_NullAlarmCallback
      Rte_TimeoutAlarm6
        Action (OsAlarmAction)
          Callback (OsAlarmCallback): OsAlarmCallbackName=Rte_NullAlarmCallback
      Rte_TimeoutAlarm7
        Action (OsAlarmAction)
          Callback (OsAlarmCallback): OsAlarmCallbackName=Rte_NullAlarmCallback
      Rte_TimeoutAlarm8
        Action (OsAlarmAction)
          Callback (OsAlarmCallback): OsAlarmCallbackName=Rte_NullAlarmCallback
